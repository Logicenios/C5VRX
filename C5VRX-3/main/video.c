/**
 * video.c - Realtime MODEM_DIAG -> PARLIO RX -> 16K ring -> Phase5 TX -> DAC.
 *
 * Implements the complete production datapath for C5VRX-3:
 *
 *   MODEM_DIAG full Q4/I4 @ 40 MS/s
 *     -> PARLIO RX POS edge @ 40 MHz
 *     -> 16 KiB cyclic raw DMA ring (HP SRAM)
 *     -> PARLIO TX @ 40 MHz + Phase5 TX BitScrambler (fm.bsasm)
 *     -> [D,D] 6-bit CVBS @ 20 MS/s unique / 40 MHz DAC clock
 *     -> 6-bit resistor DAC
 *
 * Reference: Seamless Golden 16K (build-golden-notel) -- proven best live build.
 *
 * Fixed production constants (NOT configurable at runtime):
 *   IQ rate:        40 MHz
 *   DAC rate:       40 MHz physical ([D,D] = 20 MS/s unique CVBS)
 *   Ring:           16384 bytes (HP SRAM, DMA-aligned)
 *   Pedestal:       20   (hardcoded in FM LUT)
 *   Gain:           2    (hardcoded in FM LUT)
 *   Polarity:       current-minus-previous (hardcoded in FM LUT)
 *   RX sample edge: POS
 *   TX shift edge:  NEG
 *   BS EOF:         downstream (PARLIO TX loop never generates downstream EOF)
 *   BS tail:        0 bytes
 *
 * After video_start() the CPU has nothing to do. No periodic tasks or timers.
 */

#include "video.h"
#include "rf.h"

#include <stdint.h>
#include <string.h>

#include "driver/bitscrambler.h"
#include "driver/gpio.h"
#include "driver/parlio_bitscrambler.h"
#include "driver/parlio_rx.h"
#include "driver/parlio_tx.h"
#include "esp_attr.h"
#include "esp_cache.h"
#include "esp_log.h"
#include "esp_rom_sys.h"
#include "esp_timer.h"
#include "freertos/FreeRTOS.h"
#include "freertos/task.h"
#include "soc/parl_io_struct.h"
#include "soc/bitscrambler_struct.h"
#include "soc/ahb_dma_struct.h"
#include "soc/pcr_struct.h"
#include "modem/modem_syscon_reg.h"
#include "hal/dma_types.h"
#include "esp_clock_output.h"

/* Hardware diagnostic counters in IRAM to measure transport hiccups without printf spam */
typedef struct {
    uint32_t parl_rx_wovf_count;
    uint32_t parl_tx_rempty_count;
    uint32_t parl_tx_eof_count;
    uint32_t bs_fifo_empty_count;
    uint32_t bs_eof_overload_count;
    uint32_t checks;
} hw_transport_counters_t;

static volatile hw_transport_counters_t s_hw_counters;

/* fm.bsasm program symbol generated by target_bitscrambler_add_src(). */
BITSCRAMBLER_PROGRAM(s_fm_program, "fm");

/* ----- Fixed production constants ----- */
#define IQ_RATE_HZ       40000000u   /* MODEM_DIAG / PARLIO RX clock */
#define DAC_RATE_HZ      40000000u   /* PARLIO TX clock ([D,D] = 20 MS/s unique) */
#define RAW_RING_BYTES   16384u      /* 16384 byte cyclic ring (16 KiB Seamless Golden) */
#define DAC_IDLE_CODE    20u         /* Pedestal 20 (sync tip level) */

/* TX GPIO mapping: 6-bit resistor DAC.
 * Order: DAC bit 0 (LSB) .. DAC bit 5 (MSB) on data_gpio_nums[0..5].
 * Bits 6..7 unused (set to -1).
 * Verified against C5VRX-2 realtime.c (standard 8-bit PARLIO TX, non-parlio4). */
static const int s_dac_gpio[8] = {23, 24, 11, 12, 8, 9, -1, -1};

_Static_assert(IQ_RATE_HZ == 40000000u, "IQ rate must be 40 MHz");
_Static_assert(DAC_RATE_HZ == 40000000u, "DAC rate must be 40 MHz");
_Static_assert(RAW_RING_BYTES == 16384u, "Ring must be exactly 16384 bytes");

static const char *TAG = "c5vrx3_video";

/* DMA-aligned ring buffer in HP SRAM.
 * RX GDMA writes at 40 MB/s; TX GDMA reads at 40 MB/s.
 * TX starts one block (4096 bytes = 102.4 µs) behind RX; they share
 * PLL_F240M/6, so separation cannot drift during normal operation. */
static DMA_ATTR __attribute__((aligned(64))) uint8_t s_raw_ring[RAW_RING_BYTES];

static parlio_rx_unit_handle_t      s_rx;
static parlio_rx_delimiter_handle_t s_rx_delimiter;
static parlio_tx_unit_handle_t      s_tx;

/* ----- PARLIO RX setup ----- */

static esp_err_t prepare_rx(void)
{
    /* Proven PARLIO RX config with clean internal SPLL clock */
    const parlio_rx_unit_config_t cfg = {
        .trans_queue_depth = 1u,
        .max_recv_size     = sizeof(s_raw_ring),
        .dma_burst_size    = 32u,
        .data_width        = 8u,
        .clk_src           = PARLIO_CLK_SRC_DEFAULT,
        .ext_clk_freq_hz   = 0u,
        .exp_clk_freq_hz   = IQ_RATE_HZ,
        .clk_in_gpio_num   = -1,
        .clk_out_gpio_num  = -1,
        .valid_gpio_num    = -1,
        /* GPIO order must match s_iq_pins[] in rf.c:
         * Q[9:6] on GPIO 1,0,25,7 then I[9:6] on GPIO 10,5,3,4. */
        .data_gpio_nums    = {
            GPIO_NUM_1, GPIO_NUM_0, GPIO_NUM_25, GPIO_NUM_7,
            GPIO_NUM_10, GPIO_NUM_5, GPIO_NUM_3, GPIO_NUM_4,
        },
        .flags = {
            .free_clk    = true,   /* RX clock is derived from PHY, not gated */
            .clk_gate_en = false,
            .allow_pd    = false,
        },
    };
    esp_err_t err = parlio_new_rx_unit(&cfg, &s_rx);
    if (err != ESP_OK) return err;

    /* Soft delimiter in infinite (partial_rx_en) mode.
     * POS sample edge -- proven correct for internal clock. */
    const parlio_rx_soft_delimiter_config_t delim_cfg = {
        .sample_edge  = PARLIO_SAMPLE_EDGE_POS,
        .bit_pack_order = PARLIO_BIT_PACK_ORDER_LSB,
        .eof_data_len = sizeof(s_raw_ring),
        .timeout_ticks = 0u,
    };
    err = parlio_new_rx_soft_delimiter(&delim_cfg, &s_rx_delimiter);
    if (err != ESP_OK) return err;

    return parlio_rx_unit_enable(s_rx, false);
}

/* ----- PARLIO TX setup ----- */

static esp_err_t prepare_tx(void)
{
    /* Proven PARLIO TX config from Seamless Golden 16K reference.
     * 8-bit data width, 40 MHz output, NEG shift edge, LSB packing.
     * BitScrambler decorated on the TX unit (not RX -- C5 has one BS). */
    const parlio_tx_unit_config_t cfg = {
        .clk_src              = PARLIO_CLK_SRC_DEFAULT,
        .clk_in_gpio_num      = -1,
        .input_clk_src_freq_hz = 0u,
        .output_clk_freq_hz   = DAC_RATE_HZ,
        .data_width           = 8u,
        .data_gpio_nums       = {
            s_dac_gpio[0], s_dac_gpio[1], s_dac_gpio[2], s_dac_gpio[3],
            s_dac_gpio[4], s_dac_gpio[5], s_dac_gpio[6], s_dac_gpio[7],
        },
        .clk_out_gpio_num  = -1,
        .valid_gpio_num    = -1,
        .valid_start_delay = 0,
        .valid_stop_delay  = 0,
        .trans_queue_depth = 1u,
        .max_transfer_size = sizeof(s_raw_ring),
        .dma_burst_size    = 32u,
        .shift_edge        = PARLIO_SHIFT_EDGE_NEG,   /* FIXED: NEG (RX is POS) */
        .bit_pack_order    = PARLIO_BIT_PACK_ORDER_LSB,
    };
    esp_err_t err = parlio_new_tx_unit(&cfg, &s_tx);
    if (err != ESP_OK) return err;

    /* Decorate TX with BitScrambler (TX-only; C5 has one shared BS core). */
    err = parlio_tx_unit_decorate_bitscrambler(s_tx);
    if (err != ESP_OK) return err;

    return parlio_tx_unit_enable(s_tx);
}

/* ----- Start RX cyclic ring ----- */

static esp_err_t start_rx(void)
{
    esp_err_t err = parlio_rx_soft_delimiter_start_stop(s_rx, s_rx_delimiter, true);
    if (err != ESP_OK) return err;
    const parlio_receive_config_t cfg = {
        .delimiter = s_rx_delimiter,
        .flags = {
            .partial_rx_en   = true,
            .indirect_mount  = false,
        },
    };
    return parlio_rx_unit_receive(s_rx, s_raw_ring, sizeof(s_raw_ring), &cfg);
}

/* ----- Start TX loop ----- */

static esp_err_t start_tx(void)
{
    /* Phase5 LUT is embedded in fm.bsasm -- no runtime bitscrambler_load_lut().
     * Hardware oracle v9 proved embedded LUT is byte-exact at 20 MS/s;
     * a separately preloaded LUT is NOT retained by the active PARLIO TX run. */
    const parlio_transmit_config_t cfg = {
        .idle_value          = DAC_IDLE_CODE,
        .bitscrambler_program = s_fm_program,
        .flags.loop_transmission = true,  /* Infinite -- never generates downstream EOF */
    };
    /* TX reads sizeof(s_raw_ring) * 8 bits, then loops.
     * loop_transmission=true means PARLIO TX never stops; the BitScrambler
     * with eof_on=downstream therefore runs uninterrupted forever. */
    return parlio_tx_unit_transmit(s_tx, s_raw_ring,
                                   sizeof(s_raw_ring) * 8u, &cfg);
}

static int s_rx_dma_ch = -1;
static int s_tx_dma_ch = -1;

static inline uint32_t get_rx_dma_offset(uint32_t *out_dscr_addr)
{
    if (s_rx_dma_ch < 0 || s_rx_dma_ch >= 3) return 0;
    uint32_t dscr_addr = AHB_DMA.channel[s_rx_dma_ch].in.in_dscr_bf0.val;
    if (out_dscr_addr) *out_dscr_addr = dscr_addr;
    if (dscr_addr >= 0x40800000u && dscr_addr < 0x40860000u) {
        dma_descriptor_t *dscr = (dma_descriptor_t *)(uintptr_t)dscr_addr;
        uint8_t *buf = (uint8_t *)dscr->buffer;
        if (buf >= s_raw_ring && buf < s_raw_ring + sizeof(s_raw_ring)) {
            return (uint32_t)(buf - s_raw_ring);
        }
    }
    return 0;
}

static inline uint32_t get_tx_dma_offset(uint32_t *out_dscr_addr)
{
    if (s_tx_dma_ch < 0 || s_tx_dma_ch >= 3) return 0;
    uint32_t dscr_addr = AHB_DMA.channel[s_tx_dma_ch].out.out_dscr_bf0.val;
    if (out_dscr_addr) *out_dscr_addr = dscr_addr;
    if (dscr_addr >= 0x40800000u && dscr_addr < 0x40860000u) {
        dma_descriptor_t *dscr = (dma_descriptor_t *)(uintptr_t)dscr_addr;
        uint8_t *buf = (uint8_t *)dscr->buffer;
        if (buf >= s_raw_ring && buf < s_raw_ring + sizeof(s_raw_ring)) {
            return (uint32_t)(buf - s_raw_ring);
        }
    }
    return 0;
}

static int patch_descriptors_clear_eof(int dma_ch, bool is_rx)
{
    if (dma_ch < 0 || dma_ch >= 3) return 0;
    uint32_t first_addr = is_rx ? AHB_DMA.channel[dma_ch].in.in_dscr_bf0.val
                                : AHB_DMA.channel[dma_ch].out.out_dscr_bf0.val;
    if (first_addr < 0x40800000u || first_addr >= 0x40860000u) return 0;

    dma_descriptor_t *curr = (dma_descriptor_t *)(uintptr_t)first_addr;
    int count = 0;
    while (curr && count < 64) {
        curr->dw0.suc_eof = 0;
        (void)esp_cache_msync(curr, sizeof(dma_descriptor_t), ESP_CACHE_MSYNC_FLAG_DIR_C2M);
        curr = curr->next;
        count++;
        if ((uintptr_t)curr == first_addr) break;
    }
    __asm__ __volatile__("fence rw, rw" ::: "memory");
    return count;
}

/* =========================================================================
 * Analog Video Self-Calibrating Adaptive Gain Controller (Dual-Loop)
 *
 * Direct Q4/I4 vector power: P[n] = I[n]^2 + Q[n]^2
 * Target: P_median in [20, 30] (effective radius ~4.5 - 5.5, phase sigma ~3.3 deg)
 *
 * Fast Overload Rem: Instant drop (-4 or -6) when n_clip >= 4 AND P_median > 18.
 * FM Phase Coherence: Q_phase = count(P >= 8 && dot > 0 && |cross| <= dot) * 100 / 255.
 *
 * 3-State Machine:
 *   - SEARCH: No carrier / lost carrier (q_phase < 40%, P_med < 14). Default G=32.
 *   - LEARN:  Probing & centering toward P_median in [20, 30].
 *   - TRACK:  Carrier locked! Hysteresis deadband [18, 32]. ZERO register writes.
 *
 * Modes:
 *   - ANALOG_AGC_SHADOW: Default! Realtime state machine & Q_phase active, logs
 *                        recommendations, but PHYSICAL GAIN IS FROZEN (no blackouts).
 *   - ANALOG_AGC_ACTIVE: Actively updates physical RF gain registers.
 *   - ANALOG_AGC_MANUAL: Fixed gain controlled by user (+ / - keys).
 * ========================================================================= */

typedef enum {
    ANALOG_AGC_SHADOW = 0,
    ANALOG_AGC_ACTIVE = 1,
    ANALOG_AGC_MANUAL = 2,
} analog_agc_mode_t;

typedef enum {
    AGC_STATE_SEARCH = 0,
    AGC_STATE_LEARN  = 1,
    AGC_STATE_TRACK  = 2,
} agc_state_t;

typedef enum {
    BW_GEAR_AUTO = 0, /* Dynamic Bandwidth Adaptation: BW40 normally, BW20 in deep fade */
    BW_GEAR_BW40 = 1, /* Forced BW40 (20 MHz baseband, full color) */
    BW_GEAR_BW20 = 2, /* Forced BW20 (10 MHz baseband, +3 dB sensitivity) */
} bw_gear_mode_t;

typedef enum {
    AFC_MODE_AUTO = 0, /* Auto Carrier Centering: centers within safe +/-1.5 MHz bound when locked */
    AFC_MODE_HOLD = 1, /* AFC Hold: freeze current offset */
    AFC_MODE_OFF  = 2, /* AFC Off: reset to 0 kHz offset */
} afc_mode_t;

static volatile analog_agc_mode_t s_agc_mode = ANALOG_AGC_ACTIVE;
static volatile agc_state_t s_agc_state = AGC_STATE_SEARCH;
static volatile bw_gear_mode_t s_bw_gear_mode = BW_GEAR_AUTO;
static volatile afc_mode_t s_afc_mode = AFC_MODE_AUTO;
static volatile bool s_current_bw40 = true;
static volatile uint8_t s_current_gain = 32u;   /* Physical RF gain applied */
static volatile uint8_t s_shadow_gain = 32u;    /* Controller recommended gain */
static volatile int s_last_p_median = 25;
static volatile int s_last_q_phase = 0;
static volatile int s_last_n_clip = 0;
static volatile int s_last_n_origin = 0;
static volatile int s_cfo_khz = 0;              /* Carrier Frequency Offset in kHz */

static void analog_agc_task(void *arg)
{
    (void)arg;
    int settle_ticks = 0;
    int drift_counter = 0;
    int lost_counter = 0;
    int deep_fade_ticks = 0;
    int strong_signal_ticks = 0;
    int afc_ticks = 0;
    int telemetry_ticks = 0;
    uint8_t target_gain = 32u;

    for (;;) {
        vTaskDelay(pdMS_TO_TICKS(50)); /* 20 Hz evaluation (every 50 ms) */

        if (s_agc_mode == ANALOG_AGC_MANUAL) {
            target_gain = s_current_gain;
            s_shadow_gain = s_current_gain;
            continue;
        }

        /* 1. Invalidate 256 bytes in CPU L1 cache so we read fresh GDMA samples from SRAM */
        (void)esp_cache_msync((void *)s_raw_ring, 256, ESP_CACHE_MSYNC_FLAG_DIR_M2C);

        uint8_t sample_buf[256];
        for (int i = 0; i < 256; i++) {
            sample_buf[i] = s_raw_ring[i];
        }

        int n_clip = 0;
        int n_origin = 0;
        int n_coherent = 0;
        int sum_cross = 0;
        int sum_dot = 0;
        uint16_t hist[129] = {0};
        int8_t prev_i = 0, prev_q = 0;

        for (int i = 0; i < 256; i++) {
            uint8_t byte = sample_buf[i];
            int8_t q = (int8_t)((byte & 0x0fu) << 4) >> 4;
            int8_t in_val = (int8_t)(byte & 0xf0u) >> 4;

            if (in_val == -8 || in_val == 7 || q == -8 || q == 7) {
                n_clip++;
            }
            int p = (int)in_val * in_val + (int)q * q;
            if (p <= 4) {
                n_origin++;
            }
            if (p > 128) p = 128;
            hist[p]++;

            if (i > 0) {
                int dot = (int)in_val * (int)prev_i + (int)q * (int)prev_q;
                int signed_cross = (int)q * (int)prev_i - (int)in_val * (int)prev_q;
                int abs_cross = (signed_cross < 0) ? -signed_cross : signed_cross;

                /* Coherent FM sample: carrier power >= 8, phase delta within +-45 deg */
                if (p >= 8 && dot > 0 && abs_cross <= dot) {
                    n_coherent++;
                    sum_cross += signed_cross;
                    sum_dot += dot;
                }
            }
            prev_i = in_val;
            prev_q = q;
        }

        int cum = 0;
        int p_median = 0;
        for (int b = 0; b <= 128; b++) {
            cum += hist[b];
            if (cum >= 128) {
                p_median = b;
                break;
            }
        }
        int q_phase = (n_coherent * 100) / 255;

        s_last_p_median = p_median;
        s_last_q_phase = q_phase;
        s_last_n_clip = n_clip;
        s_last_n_origin = n_origin;

        /* Carrier Frequency Offset (CFO) Calculation:
         * Delta_f = (Cross / Dot) * (fs / 2pi) = (Cross / Dot) * 6366 kHz. */
        if (n_coherent >= 30 && sum_dot > 0) {
            int instant_cfo = (int)(((int64_t)sum_cross * 6366LL) / sum_dot);
            if (instant_cfo > 2000)  instant_cfo = 2000;
            if (instant_cfo < -2000) instant_cfo = -2000;
            s_cfo_khz = (s_cfo_khz * 7 + instant_cfo) / 8;
        }

        /* Settle delay after gain change */
        if (settle_ticks > 0) {
            settle_ticks--;
            goto update_telemetry;
        }

        /* 2. Fast Overload Safety Rem:
         * Only triggers if BOTH clipping occurs AND median power is high!
         * Prevents the "noise trap" where thermal noise peaks look like overload. */
        if (n_clip >= 4 && p_median > 18) {
            int drop = (n_clip >= 16) ? 6 : 4;
            target_gain = (target_gain > drop + 2) ? (target_gain - drop) : 2;
            s_agc_state = AGC_STATE_LEARN;
            settle_ticks = 2; /* 100 ms settle */
            drift_counter = 0;
            lost_counter = 0;
            goto apply_target;
        }

        /* 3. State Machine */
        switch (s_agc_state) {
        case AGC_STATE_SEARCH:
            /* Carrier detection threshold: phase coherence >= 55% or solid power */
            if (q_phase >= 55 || (p_median >= 18 && n_origin < 40)) {
                s_agc_state = AGC_STATE_LEARN;
                drift_counter = 0;
                lost_counter = 0;
            } else {
                /* No carrier / noise: park at baseline sweet spot, do NOT hunt */
                target_gain = 34u;
            }
            break;

        case AGC_STATE_LEARN:
            /* Center P_median into [20, 30] target zone */
            if (p_median > 30) {
                target_gain = (target_gain > 3) ? (target_gain - 2) : 2;
                settle_ticks = 1;
            } else if (p_median < 20) {
                /* If carrier is coherent, climb up to 62.
                 * If in pure noise (q_phase < 25%), cap gain at 40 to avoid noise confetti! */
                int max_gain = (q_phase >= 30) ? 62 : 40;
                int step = (p_median < 12 || n_origin > 60) ? 4 : 2;
                if ((int)target_gain + step <= max_gain) {
                    target_gain += step;
                } else {
                    target_gain = (uint8_t)max_gain;
                }
                settle_ticks = 1;
            } else {
                /* Converged into target zone with low clipping */
                if (n_clip <= 2) {
                    s_agc_state = AGC_STATE_TRACK;
                    drift_counter = 0;
                    lost_counter = 0;
                }
            }
            break;

        case AGC_STATE_TRACK:
            /* Check for carrier loss */
            if (q_phase < 35 && p_median < 12) {
                lost_counter++;
                if (lost_counter >= 8) { /* ~400 ms persistent loss */
                    s_agc_state = AGC_STATE_SEARCH;
                    lost_counter = 0;
                    break;
                }
            } else {
                lost_counter = 0;
            }

            /* Check for drift outside deadband [18, 32] */
            if (p_median < 18 || p_median > 32) {
                drift_counter++;
                if (drift_counter >= 3) { /* Drift persisted for 150 ms */
                    s_agc_state = AGC_STATE_LEARN;
                    drift_counter = 0;
                }
            } else {
                drift_counter = 0;
                /* Inside deadband: 100% frozen, ZERO register writes */
            }
            break;
        }

apply_target:
        s_shadow_gain = target_gain;
        if (s_agc_mode == ANALOG_AGC_ACTIVE) {
            if (target_gain != s_current_gain) {
                s_current_gain = target_gain;
                rf_set_rx_gain(true, s_current_gain);
            }
        }

        /* 4. Dynamic Bandwidth Gearbox (BW40 High Gear <-> BW20 Long-Range Survival) */
        if (s_bw_gear_mode == BW_GEAR_AUTO) {
            if (s_current_bw40) {
                /* In BW40: downshift to BW20 if entering deep fade / severe starvation */
                if (s_current_gain >= 58u && (p_median < 12 || q_phase < 45)) {
                    deep_fade_ticks++;
                    if (deep_fade_ticks >= 4) { /* Persisted for 200 ms */
                        s_current_bw40 = false;
                        rf_set_analog_bandwidth(false); /* DOWNSHIFT to BW20 (+3 dB boost!) */
                        deep_fade_ticks = 0;
                        strong_signal_ticks = 0;
                        settle_ticks = 2;
                    }
                } else {
                    deep_fade_ticks = 0;
                }
            } else {
                /* In BW20: upshift to BW40 if signal strongly recovered */
                if (p_median >= 22 && q_phase >= 80) {
                    strong_signal_ticks++;
                    if (strong_signal_ticks >= 20) { /* Persisted continuously for 1.0s */
                        s_current_bw40 = true;
                        rf_set_analog_bandwidth(true); /* UPSHIFT to BW40 (restore full color!) */
                        strong_signal_ticks = 0;
                        deep_fade_ticks = 0;
                        settle_ticks = 2;
                    }
                } else {
                    strong_signal_ticks = 0;
                }
            }
        } else if (s_bw_gear_mode == BW_GEAR_BW40) {
            if (!s_current_bw40) {
                s_current_bw40 = true;
                rf_set_analog_bandwidth(true);
            }
        } else if (s_bw_gear_mode == BW_GEAR_BW20) {
            if (s_current_bw40) {
                s_current_bw40 = false;
                rf_set_analog_bandwidth(false);
            }
        }

        /* 5. Automatic Frequency Control (AFC) Carrier Centering */
        if (s_afc_mode == AFC_MODE_AUTO) {
            /* Only adjust if carrier is strongly locked (Q_phase >= 75%) and gain settled */
            if (q_phase >= 75 && p_median >= 18 && settle_ticks == 0) {
                /* Centering deadband: +/- 35 kHz. Inside deadband = 0 register writes */
                if (s_cfo_khz > 35 || s_cfo_khz < -35) {
                    afc_ticks++;
                    if (afc_ticks >= 20) { /* Persisted for 1.0 second */
                        int cur_offset = rf_get_frequency_offset_khz();
                        int target_offset = cur_offset + s_cfo_khz;
                        rf_set_frequency_offset_khz(target_offset);
                        afc_ticks = 0;
                        settle_ticks = 2;
                    }
                } else {
                    afc_ticks = 0;
                }
            } else {
                afc_ticks = 0; /* Frozen during noise or deep fades: NO drifting away! */
            }
        } else if (s_afc_mode == AFC_MODE_OFF) {
            if (rf_get_frequency_offset_khz() != 0) {
                rf_set_frequency_offset_khz(0);
            }
        }

update_telemetry:
        telemetry_ticks++;
        if (telemetry_ticks >= 20) { /* 1 Hz periodic telemetry log */
            telemetry_ticks = 0;
            const fpv_channel_t *ch = rf_get_current_channel();
            int cur_off = rf_get_frequency_offset_khz();
            int total_khz = (int)ch->freq_mhz * 1000 + cur_off;
            printf("[AGC:%s] %-5s BW=%-4s | %s:%d.%03dMHz %+4dkHz (CFO=%+4d kHz) | G=%u | P=%-2d Q=%2d%% | c=%-2d\n",
                   (s_agc_mode == ANALOG_AGC_ACTIVE) ? "ACT" :
                   (s_agc_mode == ANALOG_AGC_SHADOW) ? "SHD" : "MAN",
                   (s_agc_state == AGC_STATE_TRACK) ? "TRACK" :
                   (s_agc_state == AGC_STATE_LEARN) ? "LEARN" : "SRCH",
                   s_current_bw40 ? "BW40" : "BW20",
                   ch->name,
                   total_khz / 1000,
                   (total_khz % 1000 >= 0 ? total_khz % 1000 : -(total_khz % 1000)),
                   cur_off,
                   s_cfo_khz,
                   s_current_gain,
                   s_last_p_median, s_last_q_phase, s_last_n_clip);
            fflush(stdout);
        }
    }
}

static void console_diag_task(void *arg)
{
    (void)arg;
    for (;;) {
        int c = getchar();
        if (c != EOF && c > 0) {
            if (c == '+' || c == 'k') {
                s_agc_mode = ANALOG_AGC_MANUAL;
                if (s_current_gain < 62u) s_current_gain += 2u;
                rf_set_rx_gain(true, s_current_gain);
                printf("[MANUAL GAIN] = %u (reg=0x%08lx)\n", s_current_gain, (unsigned long)rf_get_rx_gain_reg());
            } else if (c == '-' || c == 'j') {
                s_agc_mode = ANALOG_AGC_MANUAL;
                if (s_current_gain >= 2u) s_current_gain -= 2u;
                rf_set_rx_gain(true, s_current_gain);
                printf("[MANUAL GAIN] = %u (reg=0x%08lx)\n", s_current_gain, (unsigned long)rf_get_rx_gain_reg());
            } else if (c == 'a') {
                s_agc_mode = ANALOG_AGC_ACTIVE;
                printf("[AGC MODE] -> ACTIVE (Self-Calibrating Adaptive Gain Controller ACTIVE)\n");
            } else if (c == 's') {
                s_agc_mode = ANALOG_AGC_SHADOW;
                printf("[AGC MODE] -> SHADOW (Dry-run: RF gain frozen at %u, computing recommendations)\n", s_current_gain);
            } else if (c == 'm') {
                s_agc_mode = ANALOG_AGC_MANUAL;
                printf("[AGC MODE] -> MANUAL (Fixed gain=%u)\n", s_current_gain);
            } else if (c == 'b') {
                if (s_bw_gear_mode == BW_GEAR_AUTO) {
                    s_bw_gear_mode = BW_GEAR_BW40;
                    s_current_bw40 = true;
                    rf_set_analog_bandwidth(true);
                    printf("[BW GEAR] -> FORCED BW40 (Full color / 20 MHz baseband)\n");
                } else if (s_bw_gear_mode == BW_GEAR_BW40) {
                    s_bw_gear_mode = BW_GEAR_BW20;
                    s_current_bw40 = false;
                    rf_set_analog_bandwidth(false);
                    printf("[BW GEAR] -> FORCED BW20 (+3 dB SNR Long-Range Survival mode)\n");
                } else {
                    s_bw_gear_mode = BW_GEAR_AUTO;
                    printf("[BW GEAR] -> AUTO GEARBOX (Dynamic Bandwidth Adaptation)\n");
                }
            } else if (c == 'c') {
                rf_cycle_channel();
                const fpv_channel_t *ch = rf_get_current_channel();
                s_cfo_khz = 0;
                s_agc_state = AGC_STATE_SEARCH;
                printf("[CHANNEL] Switched to %s (%u MHz)\n", ch->name, ch->freq_mhz);
            } else if (c == 'f') {
                if (s_afc_mode == AFC_MODE_AUTO) {
                    s_afc_mode = AFC_MODE_HOLD;
                    printf("[AFC] -> HOLD (Current offset %+d kHz frozen)\n", rf_get_frequency_offset_khz());
                } else if (s_afc_mode == AFC_MODE_HOLD) {
                    s_afc_mode = AFC_MODE_OFF;
                    rf_set_frequency_offset_khz(0);
                    printf("[AFC] -> OFF (Offset reset to 0 kHz)\n");
                } else {
                    s_afc_mode = AFC_MODE_AUTO;
                    printf("[AFC] -> AUTO CENTERING (Active tracking within +/- 1.5 MHz)\n");
                }
            } else if (c == ',' || c == '<') {
                rf_step_frequency_offset_khz(-50);
                int off = rf_get_frequency_offset_khz();
                int tot = (int)rf_get_current_channel()->freq_mhz * 1000 + off;
                printf("[FINE TUNE] Offset = %+d kHz (Tuned: %d.%03d MHz)\n",
                       off, tot / 1000, (tot % 1000 >= 0 ? tot % 1000 : -(tot % 1000)));
            } else if (c == '.' || c == '>') {
                rf_step_frequency_offset_khz(+50);
                int off = rf_get_frequency_offset_khz();
                int tot = (int)rf_get_current_channel()->freq_mhz * 1000 + off;
                printf("[FINE TUNE] Offset = %+d kHz (Tuned: %d.%03d MHz)\n",
                       off, tot / 1000, (tot % 1000 >= 0 ? tot % 1000 : -(tot % 1000)));
            } else if (c == '0') {
                rf_set_frequency_offset_khz(0);
                printf("[FINE TUNE] Offset reset to +0 kHz\n");
            } else if (c == 'e') {
                PARL_IO.rx_clk_cfg.rx_clk_i_inv = !PARL_IO.rx_clk_cfg.rx_clk_i_inv;
                printf("[EDGE] RX SAMPLE EDGE TOGGLED -> %s (rx_clk_i_inv=%d)\n",
                       PARL_IO.rx_clk_cfg.rx_clk_i_inv ? "NEG" : "POS",
                       (int)PARL_IO.rx_clk_cfg.rx_clk_i_inv);
            } else {
                uint32_t rx_dscr = 0, tx_dscr = 0;
                uint32_t rx_off = get_rx_dma_offset(&rx_dscr);
                uint32_t tx_off = get_tx_dma_offset(&tx_dscr);
                uint32_t dist = (rx_off >= tx_off) ? (rx_off - tx_off) : (sizeof(s_raw_ring) - tx_off + rx_off);
                int rx_nodes = patch_descriptors_clear_eof(s_rx_dma_ch, true);
                int tx_nodes = patch_descriptors_clear_eof(s_tx_dma_ch, false);
                const fpv_channel_t *ch = rf_get_current_channel();
                int off = rf_get_frequency_offset_khz();
                int tot = (int)ch->freq_mhz * 1000 + off;

                printf("\n=======================================================\n");
                printf(" C5VRX-3 REALTIME RECEPTION & FREQUENCY DIAGNOSTICS\n");
                printf(" Receiver Channel:           %s (%u MHz)\n", ch->name, ch->freq_mhz);
                printf(" Tuned Frequency:            %d.%03d MHz (Offset: %+d kHz)\n",
                       tot / 1000, (tot % 1000 >= 0 ? tot % 1000 : -(tot % 1000)), off);
                printf(" Carrier Frequency Offset:   %+d kHz (VTX %s)\n",
                       s_cfo_khz, (s_cfo_khz > 20) ? "high" : (s_cfo_khz < -20) ? "low" : "centered");
                printf(" AFC Mode:                   %s\n",
                       (s_afc_mode == AFC_MODE_AUTO) ? "AUTO (Carrier Centering, +/-1.5 MHz safe bound)" :
                       (s_afc_mode == AFC_MODE_HOLD) ? "HOLD (Offset Frozen)" : "OFF (0 kHz)");
                printf(" Bandwidth Gear:             %s (Current: %s)\n",
                       (s_bw_gear_mode == BW_GEAR_AUTO) ? "AUTO (Dynamic Adaptation)" :
                       (s_bw_gear_mode == BW_GEAR_BW40) ? "FORCED BW40" : "FORCED BW20",
                       s_current_bw40 ? "BW40 (Wide / Color)" : "BW20 (Narrow / +3 dB Survival)");
                printf(" Adaptive AGC Mode:          %s (State=%s)\n",
                       (s_agc_mode == ANALOG_AGC_ACTIVE) ? "ACTIVE" :
                       (s_agc_mode == ANALOG_AGC_SHADOW) ? "SHADOW (Safe Dry-Run)" : "MANUAL",
                       (s_agc_state == AGC_STATE_TRACK) ? "TRACK" :
                       (s_agc_state == AGC_STATE_LEARN) ? "LEARN" : "SEARCH");
                printf(" Gain Settings:              G_actual=%u, G_shadow_rec=%u (reg=0x%08lx)\n",
                       s_current_gain, s_shadow_gain, (unsigned long)rf_get_rx_gain_reg());
                printf(" FM Vector Metrics:          P_median=%d, Q_phase=%d%%, Clip=%d, Origin=%d\n",
                       s_last_p_median, s_last_q_phase, s_last_n_clip, s_last_n_origin);
                printf(" GDMA Ring:                  dist=%lu (rx_off=%lu, tx_off=%lu)\n",
                       (unsigned long)dist, (unsigned long)rx_off, (unsigned long)tx_off);
                printf(" Zero-EOF Status:            RX patched=%d nodes, TX patched=%d nodes\n",
                       rx_nodes, tx_nodes);
                printf(" PARLIO TX Underflows:       %lu (Zero underflows)\n",
                       (unsigned long)s_hw_counters.parl_tx_rempty_count);
                printf(" RX Sample Edge:             %s (rx_clk_i_inv=%d)\n",
                       PARL_IO.rx_clk_cfg.rx_clk_i_inv ? "NEG" : "POS",
                       (int)PARL_IO.rx_clk_cfg.rx_clk_i_inv);
                printf(" Keys:\n");
                printf("  'a'/'s'/'m': AGC mode (active / shadow / manual)\n");
                printf("  '+' / '-':   Manual gain step (+/-2)\n");
                printf("  'b':         Bandwidth gear (auto / forced bw40 / forced bw20)\n");
                printf("  'c':         Cycle FPV channel (A1..A8, R1..R8, B1..B8, F1..F8)\n");
                printf("  'f':         AFC mode (auto-centering / hold / off)\n");
                printf("  ',' / '.':   Fine-tune offset (-50 / +50 kHz)\n");
                printf("  '0':         Reset offset to 0 kHz\n");
                printf("  'e':         Toggle RX sample edge (POS/NEG)\n");
                printf("  'd':         Print this diagnostic summary\n");
                printf("=======================================================\n\n");
            }
            fflush(stdout);
        }
        vTaskDelay(pdMS_TO_TICKS(100));
    }
}


/* ----- Main entry point ----- */

esp_err_t video_start(void)
{
    /* Zero the ring before starting. Flush to DMA-visible SRAM. */
    memset(s_raw_ring, 0, sizeof(s_raw_ring));
    (void)esp_cache_msync(s_raw_ring, sizeof(s_raw_ring),
                          ESP_CACHE_MSYNC_FLAG_DIR_C2M);

    esp_err_t err;

    if ((err = prepare_rx()) != ESP_OK) return err;
    if ((err = prepare_tx()) != ESP_OK) return err;

    /* Start RX cyclic ring. GDMA begins writing at s_raw_ring[0]. */
    if ((err = start_rx()) != ESP_OK) return err;

    /* Put PARLIO RX into pure continuous hardware mode:
     * 1. Disable all GDMA RX channel interrupts so the CPU is never interrupted
     *    (~9,775 ISRs/sec eliminated!).
     * 2. Set rx_eof_gen_sel = 1 (external enable, non-existent in soft mode)
     *    so PARLIO RX never generates an EOF stall event.
     * This matches PARLIO TX's unbroken hardware loop, eliminating pointer drift! */
    AHB_DMA.in_intr[0].ena.val = 0;
    AHB_DMA.in_intr[1].ena.val = 0;
    AHB_DMA.in_intr[2].ena.val = 0;
    PARL_IO.rx_genrl_cfg.rx_eof_gen_sel = 1;

    /* Establish producer/consumer separation before starting TX.
     * Use quarter of the ring size (4096 bytes = 102.4 µs for 16K).
     * Delay = (RAW_RING_BYTES / 4) bytes / 40,000,000 bytes/s */
    esp_rom_delay_us((RAW_RING_BYTES / 4u) * 1000000u / IQ_RATE_HZ);

    if ((err = start_tx()) != ESP_OK) return err;

    /* Discover AHB_DMA channels assigned to PARL_IO (peripheral ID 9) */
    for (int i = 0; i < 3; i++) {
        if (AHB_DMA.channel[i].in.in_peri_sel.peri_in_sel_chn == 9) {
            s_rx_dma_ch = i;
        }
        if (AHB_DMA.channel[i].out.out_peri_sel.peri_out_sel_chn == 9) {
            s_tx_dma_ch = i;
        }
    }

    /* Clear suc_eof on ALL GDMA descriptors for both RX and TX to eliminate
     * hardware wrap EOF bubbles completely! The buffer becomes a truly infinite ring. */
    int rx_nodes = patch_descriptors_clear_eof(s_rx_dma_ch, true);
    int tx_nodes = patch_descriptors_clear_eof(s_tx_dma_ch, false);

    /* Start interactive console for on-demand diagnostics (zero periodic CPU/bus traffic) */
    xTaskCreate(console_diag_task, "console_diag", 3072, NULL, 1, NULL);

    /* Start dedicated Analog Video AGC engine (P_median in [20, 30], fast attack) */
    xTaskCreate(analog_agc_task, "analog_agc", 3072, NULL, 3, NULL);

    /* Print startup stamp (visible on serial monitor at boot). */
    ESP_EARLY_LOGW(TAG,
        "\n=======================================================\n"
        " C5VRX-3  Seamless 16K Phase5 receiver (Zero-EOF Circular GDMA)\n"
        " Clock:   PARLIO_CLK_SRC_DEFAULT 40MHz (SPLL internal)\n"
        " Telemetry: Live GDMA ring pointer tracking (rx_ch=%d, tx_ch=%d)\n"
        " Buffer:  16,384 bytes cyclic ring (Zero-EOF patched: RX=%d TX=%d)\n"
        " RX:      40 MS/s POS edge, 16,384 bytes pure HW cyclic GDMA\n"
        " Demod:   Phase5 50ns / P%u / G%u / current-minus-previous\n"
        " TX:      40 MHz [D,D] / eof=downstream / tail=0\n"
        " Lock:    GDMA ISRs disabled, RX EOF disabled, suc_eof=0 cleared\n"
        " CPU:     done (hardware runs in unbroken infinite loop)\n"
        "=======================================================\n",
        s_rx_dma_ch, s_tx_dma_ch, rx_nodes, tx_nodes, DAC_IDLE_CODE, 2u);

    return ESP_OK;
}
