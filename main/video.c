/**
 * video.c - Realtime MODEM_DIAG -> PARLIO RX -> 16K ring -> Phase5 TX -> DAC.
 *
 * Implements the complete production datapath for C5VRX-3:
 *
 *   MODEM_DIAG full Q4/I4 @ 40 MS/s
 *     -> PARLIO RX POS edge @ 40 MHz
 *     -> 16 KiB cyclic raw DMA ring (HP SRAM)
 *     -> PARLIO TX @ 40 MHz + Phase5 TX BitScrambler (fm.bsasm)
 *     -> [D,D] 6-bit CVBS @ 20 MS/s unique / 40 MHz DAC clock
 *     -> 6-bit resistor DAC
 *
 * Reference: Seamless Golden 16K (build-golden-notel) -- proven best live build.
 *
 * Fixed production constants (NOT configurable at runtime):
 *   IQ rate:        40 MHz
 *   DAC rate:       40 MHz physical ([D,D] = 20 MS/s unique CVBS)
 *   Ring:           16384 bytes (HP SRAM, DMA-aligned)
 *   Pedestal:       20   (hardcoded in FM LUT)
 *   Gain:           2    (hardcoded in FM LUT)
 *   Polarity:       current-minus-previous (hardcoded in FM LUT)
 *   RX sample edge: POS
 *   TX shift edge:  NEG
 *   BS EOF:         downstream (PARLIO TX loop never generates downstream EOF)
 *   BS tail:        0 bytes
 *
 * DMA owns sample pacing; tasks handle AGC, buttons and console commands.
 */

#include "video.h"
#include "rf.h"
#include "menu_font.h"
#include "menu_raster.h"
#include "hal/parlio_ll.h"
#include "hal/usb_serial_jtag_ll.h"

#include <stdint.h>
#include <string.h>
#include <fcntl.h>
#include <unistd.h>

#include "driver/usb_serial_jtag_vfs.h"
#include "driver/bitscrambler.h"
#include "driver/gpio.h"
#include "driver/parlio_rx.h"
#include "driver/parlio_tx.h"
#include "esp_attr.h"
#include "esp_cache.h"
#include "esp_log.h"
#include "esp_rom_sys.h"
#include "esp_timer.h"
#include "freertos/FreeRTOS.h"
#include "freertos/queue.h"
#include "freertos/task.h"
#include "soc/parl_io_struct.h"
#include "soc/bitscrambler_struct.h"
#include "soc/ahb_dma_struct.h"
#include "soc/pcr_struct.h"
#include "modem/modem_syscon_reg.h"
#include "hal/dma_types.h"
#include "esp_clock_output.h"

/* Hardware diagnostic counters in IRAM to measure transport hiccups without printf spam */
typedef struct {
    uint32_t parl_rx_wovf_count;
    uint32_t parl_tx_rempty_count;
    uint32_t parl_tx_eof_count;
    uint32_t bs_fifo_empty_count;
    uint32_t bs_eof_overload_count;
    uint32_t checks;
} hw_transport_counters_t;

static volatile hw_transport_counters_t s_hw_counters;

/* fm.bsasm program symbol generated by target_bitscrambler_add_src(). */
BITSCRAMBLER_PROGRAM(s_fm_program, "fm");

/* ----- Fixed production constants ----- */
#define IQ_RATE_HZ       40000000u   /* MODEM_DIAG / PARLIO RX clock */
#define DAC_RATE_HZ      40000000u   /* PARLIO TX clock ([D,D] = 20 MS/s unique) */
#define RAW_RING_BYTES   16384u      /* 16384 byte cyclic ring (16 KiB Seamless Golden) */
#define DAC_IDLE_CODE    20u         /* Black/blanking pedestal; sync is 0 */
#define BOOT_BTN_GPIO    GPIO_NUM_28 /* Seeed Studio XIAO ESP32-C5 BOOT Button */


static volatile video_standard_t s_video_std = VIDEO_STD_NTSC;
static QueueHandle_t s_menu_commands;
static bitscrambler_handle_t s_flight_bs;

/* Cache synchronization helpers for DMA buffers and descriptors on ESP32-C5.
 * Aligns address down and size up to 64-byte cache line boundaries so esp_cache_msync
 * never fails with ESP_ERR_INVALID_ARG on unaligned descriptors or buffers. */
static inline void sync_dma_c2m(const void *addr, size_t size)
{
    if (!addr || size == 0) return;
    uint32_t start = (uint32_t)addr & ~(64u - 1u);
    uint32_t end = ((uint32_t)addr + size + 63u) & ~(64u - 1u);
    (void)esp_cache_msync((void *)start, end - start,
                          ESP_CACHE_MSYNC_FLAG_DIR_C2M | ESP_CACHE_MSYNC_FLAG_UNALIGNED);
}

static inline void sync_dma_m2c(const void *addr, size_t size)
{
    if (!addr || size == 0) return;
    uint32_t start = (uint32_t)addr & ~(64u - 1u);
    uint32_t end = ((uint32_t)addr + size + 63u) & ~(64u - 1u);
    (void)esp_cache_msync((void *)start, end - start,
                          ESP_CACHE_MSYNC_FLAG_DIR_M2C | ESP_CACHE_MSYNC_FLAG_UNALIGNED);
}

/* Timing and descriptors are immutable while running; only text pixels change.
 * This raster is never linked to the RF ring. */
static DMA_ATTR __attribute__((aligned(64))) menu_raster_t s_menu_raster;
static DMA_ATTR __attribute__((aligned(64))) dma_descriptor_t s_menu_nodes[MENU_MAX_NODES];
static unsigned s_menu_node_count;
static volatile bool s_menu_active;
static volatile bool s_menu_boot_btn_enabled = true;
static volatile int s_menu_cursor;
static int s_menu_timeout_ticks;

/* TX GPIO mapping: 6-bit resistor DAC.
 * Order: DAC bit 0 (LSB) .. DAC bit 5 (MSB) on data_gpio_nums[0..5].
 * Bits 6..7 unused (set to -1).
 * Verified against C5VRX-2 realtime.c (standard 8-bit PARLIO TX, non-parlio4). */
static const int s_dac_gpio[8] = {23, 24, 11, 12, 8, 9, -1, -1};

_Static_assert(IQ_RATE_HZ == 40000000u, "IQ rate must be 40 MHz");
_Static_assert(DAC_RATE_HZ == 40000000u, "DAC rate must be 40 MHz");
_Static_assert(RAW_RING_BYTES == 16384u, "Ring must be exactly 16384 bytes");

static const char *TAG = "c5vrx3_video";

/* DMA-aligned ring buffer in HP SRAM.
 * RX GDMA writes at 40 MB/s; TX GDMA reads at 40 MB/s.
 * TX starts one block (4096 bytes = 102.4 µs) behind RX; they share
 * PLL_F240M/6, so separation cannot drift during normal operation. */
static DMA_ATTR __attribute__((aligned(64))) uint8_t s_raw_ring[RAW_RING_BYTES];

static parlio_rx_unit_handle_t      s_rx;
static parlio_rx_delimiter_handle_t s_rx_delimiter;
static parlio_tx_unit_handle_t      s_tx;

/* ----- PARLIO RX setup ----- */

static esp_err_t prepare_rx(void)
{
    /* Proven PARLIO RX config with clean internal SPLL clock */
    const parlio_rx_unit_config_t cfg = {
        .trans_queue_depth = 1u,
        .max_recv_size     = sizeof(s_raw_ring),
        .dma_burst_size    = 32u,
        .data_width        = 8u,
        .clk_src           = PARLIO_CLK_SRC_DEFAULT,
        .ext_clk_freq_hz   = 0u,
        .exp_clk_freq_hz   = IQ_RATE_HZ,
        .clk_in_gpio_num   = -1,
        .clk_out_gpio_num  = -1,
        .valid_gpio_num    = -1,
        /* GPIO order must match s_iq_pins[] in rf.c:
         * Q[9:6] on GPIO 1,0,25,7 then I[9:6] on GPIO 10,5,3,4. */
        .data_gpio_nums    = {
            GPIO_NUM_1, GPIO_NUM_0, GPIO_NUM_25, GPIO_NUM_7,
            GPIO_NUM_10, GPIO_NUM_5, GPIO_NUM_3, GPIO_NUM_4,
        },
        .flags = {
            .free_clk    = true,   /* RX clock is derived from PHY, not gated */
            .clk_gate_en = false,
            .allow_pd    = false,
        },
    };
    esp_err_t err = parlio_new_rx_unit(&cfg, &s_rx);
    if (err != ESP_OK) return err;

    /* Soft delimiter in infinite (partial_rx_en) mode.
     * POS sample edge -- proven correct for internal clock. */
    const parlio_rx_soft_delimiter_config_t delim_cfg = {
        .sample_edge  = PARLIO_SAMPLE_EDGE_POS,
        .bit_pack_order = PARLIO_BIT_PACK_ORDER_LSB,
        .eof_data_len = sizeof(s_raw_ring),
        .timeout_ticks = 0u,
    };
    err = parlio_new_rx_soft_delimiter(&delim_cfg, &s_rx_delimiter);
    if (err != ESP_OK) return err;

    return parlio_rx_unit_enable(s_rx, false);
}

/* ----- PARLIO TX setup ----- */

static esp_err_t prepare_tx(void)
{
    /* Proven PARLIO TX config from Seamless Golden 16K reference.
     * 8-bit data width, 40 MHz output, NEG shift edge, LSB packing.
     * The explicitly owned BitScrambler attaches to TX (C5 has one BS). */
    const parlio_tx_unit_config_t cfg = {
        .clk_src              = PARLIO_CLK_SRC_DEFAULT,
        .clk_in_gpio_num      = -1,
        .input_clk_src_freq_hz = 0u,
        .output_clk_freq_hz   = DAC_RATE_HZ,
        .data_width           = 8u,
        .data_gpio_nums       = {
            s_dac_gpio[0], s_dac_gpio[1], s_dac_gpio[2], s_dac_gpio[3],
            s_dac_gpio[4], s_dac_gpio[5], s_dac_gpio[6], s_dac_gpio[7],
        },
        .clk_out_gpio_num  = -1,
        .valid_gpio_num    = -1,
        .valid_start_delay = 0,
        .valid_stop_delay  = 0,
        .trans_queue_depth = 1u,
        .max_transfer_size = sizeof(s_raw_ring),
        .dma_burst_size    = 32u,
        .shift_edge        = PARLIO_SHIFT_EDGE_NEG,   /* FIXED: NEG (RX is POS) */
        .bit_pack_order    = PARLIO_BIT_PACK_ORDER_LSB,
    };
    esp_err_t err = parlio_new_tx_unit(&cfg, &s_tx);
    if (err != ESP_OK) return err;

    /* Own the demodulator explicitly: the IDF TX disable path does not
     * disable a decorated BitScrambler on an interrupted infinite loop. */
    const bitscrambler_config_t bs_cfg = {
        .dir = BITSCRAMBLER_DIR_TX,
        .attach_to = SOC_BITSCRAMBLER_ATTACH_PARL_IO,
    };
    err = bitscrambler_new(&bs_cfg, &s_flight_bs);
    if (err != ESP_OK) return err;

    return parlio_tx_unit_enable(s_tx);
}

/* ----- Start RX cyclic ring ----- */

static esp_err_t start_rx(void)
{
    esp_err_t err = parlio_rx_soft_delimiter_start_stop(s_rx, s_rx_delimiter, true);
    if (err != ESP_OK) return err;
    const parlio_receive_config_t cfg = {
        .delimiter = s_rx_delimiter,
        .flags = {
            .partial_rx_en   = true,
            .indirect_mount  = false,
        },
    };
    return parlio_rx_unit_receive(s_rx, s_raw_ring, sizeof(s_raw_ring), &cfg);
}

/* ----- Start TX loop ----- */

static esp_err_t start_tx(void)
{
    /* Phase5 LUT is embedded in fm.bsasm -- no runtime bitscrambler_load_lut().
     * Hardware oracle v9 proved embedded LUT is byte-exact at 20 MS/s;
     * a separately preloaded LUT is NOT retained by the active PARLIO TX run. */
    const parlio_transmit_config_t cfg = {
        .idle_value          = DAC_IDLE_CODE,
        .bitscrambler_program = NULL, /* s_flight_bs is controlled explicitly */
        .flags.loop_transmission = true,  /* Infinite -- never generates downstream EOF */
    };
    /* TX reads sizeof(s_raw_ring) * 8 bits, then loops.
     * loop_transmission=true means PARLIO TX never stops; the BitScrambler
     * with eof_on=downstream therefore runs uninterrupted forever. */
    return parlio_tx_unit_transmit(s_tx, s_raw_ring,
                                   sizeof(s_raw_ring) * 8u, &cfg);
}

static int s_rx_dma_ch = -1;
static int s_tx_dma_ch = -1;

static inline uint32_t get_rx_dma_offset(uint32_t *out_dscr_addr)
{
    if (s_rx_dma_ch < 0 || s_rx_dma_ch >= 3) return 0;
    uint32_t dscr_addr = AHB_DMA.channel[s_rx_dma_ch].in.in_dscr_bf0.val;
    if (out_dscr_addr) *out_dscr_addr = dscr_addr;
    if (dscr_addr >= 0x40800000u && dscr_addr < 0x40860000u) {
        dma_descriptor_t *dscr = (dma_descriptor_t *)(uintptr_t)dscr_addr;
        uint8_t *buf = (uint8_t *)dscr->buffer;
        if (buf >= s_raw_ring && buf < s_raw_ring + sizeof(s_raw_ring)) {
            return (uint32_t)(buf - s_raw_ring);
        }
    }
    return 0;
}

static inline uint32_t get_tx_dma_offset(uint32_t *out_dscr_addr)
{
    if (s_tx_dma_ch < 0 || s_tx_dma_ch >= 3) return 0;
    uint32_t dscr_addr = AHB_DMA.channel[s_tx_dma_ch].out.out_dscr_bf0.val;
    if (out_dscr_addr) *out_dscr_addr = dscr_addr;
    if (dscr_addr >= 0x40800000u && dscr_addr < 0x40860000u) {
        dma_descriptor_t *dscr = (dma_descriptor_t *)(uintptr_t)dscr_addr;
        uint8_t *buf = (uint8_t *)dscr->buffer;
        if (buf >= s_raw_ring && buf < s_raw_ring + sizeof(s_raw_ring)) {
            return (uint32_t)(buf - s_raw_ring);
        }
    }
    return 0;
}

#define MAX_RING_DESCRIPTORS 16

typedef struct {
    dma_descriptor_t *dscr;
    uint8_t *buffer;
    uint32_t length;
} ring_dscr_node_t;

static ring_dscr_node_t s_rx_dscr_nodes[MAX_RING_DESCRIPTORS];
static int s_rx_dscr_count = 0;

static ring_dscr_node_t s_tx_dscr_nodes[MAX_RING_DESCRIPTORS];
static int s_tx_dscr_count = 0;

static inline int find_dscr_index(const ring_dscr_node_t *nodes, int count, uint32_t addr)
{
    for (int i = 0; i < count; i++) {
        if ((uintptr_t)nodes[i].dscr == addr) return i;
    }
    return -1;
}

static int patch_descriptors_clear_eof(int dma_ch, bool is_rx)
{
    if (dma_ch < 0 || dma_ch >= 3) return 0;
    uint32_t first_addr = is_rx ? AHB_DMA.channel[dma_ch].in.in_dscr_bf0.val
                                : AHB_DMA.channel[dma_ch].out.out_dscr_bf0.val;
    if (first_addr < 0x40800000u || first_addr >= 0x40860000u) return 0;

    dma_descriptor_t *curr = (dma_descriptor_t *)(uintptr_t)first_addr;
    int count = 0;
    if (is_rx) s_rx_dscr_count = 0;
    else s_tx_dscr_count = 0;

    while (curr && count < MAX_RING_DESCRIPTORS) {
        curr->dw0.suc_eof = 0;
        sync_dma_c2m(curr, sizeof(dma_descriptor_t));

        if (is_rx) {
            s_rx_dscr_nodes[count].dscr = curr;
            s_rx_dscr_nodes[count].buffer = (uint8_t *)curr->buffer;
            s_rx_dscr_nodes[count].length = curr->dw0.size ? curr->dw0.size : 4092u;
        } else {
            s_tx_dscr_nodes[count].dscr = curr;
            s_tx_dscr_nodes[count].buffer = (uint8_t *)curr->buffer;
            s_tx_dscr_nodes[count].length = curr->dw0.size ? curr->dw0.size : 4092u;
        }

        curr = curr->next;
        count++;
        if ((uintptr_t)curr == first_addr) break;
    }
    if (is_rx) s_rx_dscr_count = count;
    else s_tx_dscr_count = count;

    __asm__ __volatile__("fence rw, rw" ::: "memory");
    return count;
}

/* Pick a descriptor that RX has already completed, rather than sampling a
 * fixed address that GDMA may be overwriting at the same instant. This keeps
 * AGC/coherence decisions based on one coherent 256-byte RF snapshot. */
static uint8_t *get_completed_rx_sample_window(size_t bytes)
{
    if (s_rx_dma_ch < 0 || s_rx_dma_ch >= 3 || s_rx_dscr_count < 2) {
        return s_raw_ring;
    }

    uint32_t current_addr = AHB_DMA.channel[s_rx_dma_ch].in.in_dscr_bf0.val;
    int current_idx = find_dscr_index(s_rx_dscr_nodes, s_rx_dscr_count, current_addr);
    if (current_idx < 0) {
        return s_raw_ring;
    }

    for (int back = 1; back < s_rx_dscr_count; ++back) {
        int idx = (current_idx - back + s_rx_dscr_count) % s_rx_dscr_count;
        uint8_t *buf = s_rx_dscr_nodes[idx].buffer;
        uint32_t len = s_rx_dscr_nodes[idx].length;
        if (buf && len >= bytes &&
            buf >= s_raw_ring && (buf + bytes) <= (s_raw_ring + sizeof(s_raw_ring))) {
            return buf;
        }
    }
    return s_raw_ring;
}

/* =========================================================================
 * Receiver Modes, Dual-Loop AGC, Fixed BW40, and AFC State
 *
 * Direct Q4/I4 vector power: P[n] = I[n]^2 + Q[n]^2
 * Target: P_median in [20, 30] (effective radius ~4.5 - 5.5, phase sigma ~3.3 deg)
 *
 * Fast Overload Rem: Instant drop (-4 or -6) when n_clip >= 4 AND P_median > 18.
 * FM Phase Coherence: Q_phase = count(P >= 8 && dot > 0 && |cross| <= dot) * 100 / 255.
 *
 * 3-State Machine:
 *   - SEARCH: No carrier / lost carrier (q_phase < 40%, P_med < 14). Default G=32.
 *   - LEARN:  Probing & centering toward P_median in [20, 30].
 *   - TRACK:  Carrier locked! Hysteresis deadband [18, 32]. ZERO register writes.
 *
 * Modes:
 *   - ANALOG_AGC_SHADOW: Realtime state machine & Q_phase active, physical gain frozen.
 *   - ANALOG_AGC_ACTIVE: Default! Actively updates physical RF gain registers.
 *   - ANALOG_AGC_MANUAL: Fixed gain controlled by user (+ / - keys).
 * ========================================================================= */

typedef enum {
    ANALOG_AGC_SHADOW = 0,
    ANALOG_AGC_ACTIVE = 1,
    ANALOG_AGC_MANUAL = 2,
} analog_agc_mode_t;

typedef enum {
    AGC_STATE_SEARCH = 0,
    AGC_STATE_LEARN  = 1,
    AGC_STATE_TRACK  = 2,
} agc_state_t;

typedef enum {
    AFC_MODE_AUTO = 0, /* Auto Carrier Centering: centers within safe +/-1.5 MHz bound when locked */
    AFC_MODE_HOLD = 1, /* AFC Hold: freeze current offset */
    AFC_MODE_OFF  = 2, /* AFC Off: reset to 0 kHz offset */
} afc_mode_t;

static volatile analog_agc_mode_t s_agc_mode = ANALOG_AGC_ACTIVE;
static volatile agc_state_t s_agc_state = AGC_STATE_SEARCH;
/* WBFM instantaneous phase slope contains the video modulation itself.
 * The short-window CFO estimator is useful diagnostics, but it is not yet a
 * calibrated LO-error estimator. Never retune automatically at boot. */
static volatile afc_mode_t s_afc_mode = AFC_MODE_OFF;
static volatile uint8_t s_current_gain = 52u;   /* Physical RF gain applied */
static volatile uint8_t s_shadow_gain = 52u;    /* Controller recommended gain */
static volatile int s_last_p_median = 25;
static volatile int s_last_q_phase = 0;
static volatile int s_last_n_clip = 0;
static volatile int s_last_n_origin = 0;
static volatile int s_cfo_khz = 0;              /* Carrier Frequency Offset in kHz */

/* Menu text and timing are generated only by the AGC/control task. */
static void menu_draw_string(int row, int margin, const char *str)
{
    (void)margin;
    if (row < 0 || row >= (int)MENU_ROWS) return;
    for (unsigned y = 0; y < MENU_FONT_HEIGHT; ++y) {
        uint8_t *dst = s_menu_raster.text[row * MENU_FONT_HEIGHT + y];
        memset(dst, 20, MENU_TEXT_BYTES);
        for (unsigned ch = 0; ch < 31 && str[ch]; ++ch) {
            unsigned index = (str[ch] >= 32 && str[ch] <= 126) ? str[ch] - 32 : 0;
            uint8_t bits = s_font8x8[index][y];
            for (unsigned bit = 0; bit < 8; ++bit) {
                memset(dst + 32 + ch * 32 + bit * 4,
                       bits & (0x80u >> bit) ? 60 : 20, 4);
            }
        }
    }
}

static bool menu_append_segment(void *ctx, const uint8_t *data, unsigned length)
{
    (void)ctx;
    if (s_menu_node_count >= MENU_MAX_NODES || length > 4092 ||
        ((uintptr_t)data & 3) || (length & 3)) return false;
    dma_descriptor_t *node = &s_menu_nodes[s_menu_node_count++];
    memset(node, 0, sizeof(*node));
    node->dw0.size = length;
    node->dw0.length = length;
    node->dw0.owner = 1;
    node->buffer = (void *)data;
    node->next = &s_menu_nodes[s_menu_node_count];
    return true;
}

static void menu_render_menu(void);

static void menu_init_buffers(void)
{
    menu_raster_init(&s_menu_raster, s_video_std);
    s_menu_node_count = 0;
    ESP_ERROR_CHECK(menu_raster_emit(&s_menu_raster, s_video_std,
                                   menu_append_segment, NULL) ? ESP_OK : ESP_ERR_INVALID_SIZE);
    s_menu_nodes[s_menu_node_count - 1].next = s_menu_nodes;
    menu_render_menu();
    sync_dma_c2m(&s_menu_raster, sizeof(s_menu_raster));
    sync_dma_c2m(s_menu_nodes, s_menu_node_count * sizeof(*s_menu_nodes));
}

static void menu_render_menu(void)
{
    const fpv_channel_t *ch = rf_get_current_channel();
    char buf[40];

    snprintf(buf, sizeof(buf), "=== C5VRX-3 MENU (%s) ===",
             (s_video_std == VIDEO_STD_PAL) ? "PAL 625i" : "NTSC 525i");
    menu_draw_string(0, 16, buf);

    snprintf(buf, sizeof(buf), "%c [1] BAND:   %s",
             (s_menu_cursor == 0) ? '>' : ' ', rf_get_band_name(rf_get_current_band()));
    menu_draw_string(1, 16, buf);

    if (s_last_q_phase >= 40) {
        snprintf(buf, sizeof(buf), "%c [2] CH:     %s (%uM) [CFO:%+dk]",
                 (s_menu_cursor == 1) ? '>' : ' ', ch->name, ch->freq_mhz, s_cfo_khz);
    } else {
        snprintf(buf, sizeof(buf), "%c [2] CH:     %s (%u MHz)",
                 (s_menu_cursor == 1) ? '>' : ' ', ch->name, ch->freq_mhz);
    }
    menu_draw_string(2, 16, buf);

    snprintf(buf, sizeof(buf), "%c [3] RF BW:  BW40 (LOCKED)",
             (s_menu_cursor == 2) ? '>' : ' ');
    menu_draw_string(3, 16, buf);

    snprintf(buf, sizeof(buf), "%c [4] AFC:    %s",
             (s_menu_cursor == 3) ? '>' : ' ',
             (s_afc_mode == AFC_MODE_AUTO) ? "AUTO EXP (+/-1.5M)" :
             (s_afc_mode == AFC_MODE_HOLD) ? "HOLD (FROZEN)" : "OFF (0 kHz)");
    menu_draw_string(4, 16, buf);

    snprintf(buf, sizeof(buf), "%c [5] STD:    %s",
             (s_menu_cursor == 4) ? '>' : ' ',
             (s_video_std == VIDEO_STD_PAL) ? "PAL 625i (50Hz)" : "NTSC 525i (60Hz)");
    menu_draw_string(5, 16, buf);

    snprintf(buf, sizeof(buf), "%c [6] SAVE & EXIT",
             (s_menu_cursor == 5) ? '>' : ' ');
    menu_draw_string(6, 16, buf);

    sync_dma_c2m(s_menu_raster.text, sizeof(s_menu_raster.text));
}

static void quiet_tx_interrupts(void)
{
    AHB_DMA.out_intr[s_tx_dma_ch].ena.val = 0;
    AHB_DMA.out_intr[s_tx_dma_ch].clr.val = UINT32_MAX;
    PARL_IO.int_ena.val = 0;
}

static void start_flight_demodulator(void)
{
    ESP_ERROR_CHECK(bitscrambler_enable(s_flight_bs));
    ESP_ERROR_CHECK(bitscrambler_load_program(s_flight_bs, s_fm_program));
    ESP_ERROR_CHECK(bitscrambler_reset(s_flight_bs));
    ESP_ERROR_CHECK(bitscrambler_start(s_flight_bs));
}

static void start_menu_tx(void)
{
    /* IDF owns the channel allocation and stop/reset lifecycle. While its TX
     * transaction queue is empty, start our SRAM scatter chain directly.
     * No driver-private structure access and no active descriptor rewiring. */
    ESP_ERROR_CHECK(parlio_tx_unit_enable(s_tx));
    quiet_tx_interrupts();
    parlio_ll_tx_enable_clock(&PARL_IO, false);
    parlio_ll_tx_reset_clock(&PARL_IO);
    parlio_ll_tx_reset_fifo(&PARL_IO);
    parlio_ll_tx_set_idle_data_value(&PARL_IO, DAC_IDLE_CODE);
    parlio_ll_tx_set_eof_condition(&PARL_IO, PARLIO_LL_TX_EOF_COND_DATA_LEN);
    parlio_ll_tx_set_trans_bit_len(&PARL_IO, 1);
    __asm__ __volatile__("fence rw, rw" ::: "memory");
    AHB_DMA.out_link_addr[s_tx_dma_ch].val = (uint32_t)s_menu_nodes;
    AHB_DMA.channel[s_tx_dma_ch].out.out_link.outlink_start_chn = 1;
    int64_t deadline = esp_timer_get_time() + 1000;
    while (!parlio_ll_tx_is_ready(&PARL_IO)) {
        ESP_ERROR_CHECK(esp_timer_get_time() < deadline ? ESP_OK : ESP_ERR_TIMEOUT);
    }
    parlio_ll_tx_start(&PARL_IO, true);
    parlio_ll_tx_enable_clock(&PARL_IO, true);
}

static void video_set_menu_mode(bool active)
{
    if (s_menu_active == active) return;
    ESP_ERROR_CHECK(parlio_tx_unit_disable(s_tx));
    ESP_ERROR_CHECK(bitscrambler_disable(s_flight_bs));
    if (active) {
        menu_init_buffers();
        start_menu_tx();
    } else {
        /* Restart the producer at ring zero; delaying an already running RX
         * would leave TX's offset arbitrary. Load Phase5 before timing RX. */
        start_flight_demodulator();
        ESP_ERROR_CHECK(parlio_rx_unit_disable(s_rx));
        ESP_ERROR_CHECK(parlio_rx_unit_enable(s_rx, false));
        ESP_ERROR_CHECK(parlio_tx_unit_enable(s_tx));
        quiet_tx_interrupts();
        ESP_ERROR_CHECK(start_rx());
        AHB_DMA.in_intr[s_rx_dma_ch].ena.val = 0;
        PARL_IO.rx_genrl_cfg.rx_eof_gen_sel = 1;
        esp_rom_delay_us(8192ULL * 1000000ULL / IQ_RATE_HZ);
        ESP_ERROR_CHECK(start_tx());
        quiet_tx_interrupts();
        patch_descriptors_clear_eof(s_rx_dma_ch, true);
        patch_descriptors_clear_eof(s_tx_dma_ch, false);
    }
    s_menu_timeout_ticks = 0;
    s_menu_active = active;
}

static void menu_toggle_standard(void)
{
    if (s_menu_active) ESP_ERROR_CHECK(parlio_tx_unit_disable(s_tx));
    s_video_std = s_video_std == VIDEO_STD_PAL ? VIDEO_STD_NTSC : VIDEO_STD_PAL;
    if (s_menu_active) {
        menu_init_buffers();
        start_menu_tx();
    }
}

static void init_boot_button(void)
{
    const gpio_config_t cfg = {
        .pin_bit_mask = 1ULL << BOOT_BTN_GPIO,
        .mode = GPIO_MODE_INPUT,
        .pull_up_en = GPIO_PULLUP_ENABLE,
        .pull_down_en = GPIO_PULLDOWN_DISABLE,
        .intr_type = GPIO_INTR_DISABLE,
    };
    gpio_config(&cfg);
}

static void handle_button_short_click(void)
{
    if (s_menu_active) {
        s_menu_cursor = (s_menu_cursor + 1) % 6;
        menu_render_menu();
        s_menu_timeout_ticks = 0;
        printf("[BTN: SHORT] Menu cursor -> %d\n", s_menu_cursor);
    } else {
        rf_cycle_channel_in_band();
        s_cfo_khz = 0;
        s_agc_state = AGC_STATE_SEARCH;
        const fpv_channel_t *ch = rf_get_current_channel();
        printf("[BTN: SHORT] Channel switched to %s (%u MHz) in %s\n",
               ch->name, ch->freq_mhz, rf_get_band_name(rf_get_current_band()));
    }
}

static void handle_button_long_click(void)
{
    if (!s_menu_active) {
        if (!s_menu_boot_btn_enabled) {
            printf("[BTN: LONG] Menu menu via BOOT button is DISABLED (Safe Flight Mode)\n");
            return;
        }
        s_menu_cursor = 0;
        s_menu_timeout_ticks = 0;
        video_set_menu_mode(true);
        printf("[BTN: LONG] Menu Opened!\n");
    } else {
        switch (s_menu_cursor) {
        case 0: /* BAND */
            rf_cycle_band();
            s_cfo_khz = 0;
            s_agc_state = AGC_STATE_SEARCH;
            printf("[MENU: BAND] Switched to %s\n", rf_get_band_name(rf_get_current_band()));
            break;
        case 1: /* CHANNEL */
            rf_cycle_channel_in_band();
            s_cfo_khz = 0;
            s_agc_state = AGC_STATE_SEARCH;
            printf("[MENU: CHANNEL] Switched to %s (%u MHz)\n",
                   rf_get_current_channel()->name, rf_get_current_channel()->freq_mhz);
            break;
        case 2: /* RF BANDWIDTH STATUS (fixed production contract) */
            printf("[MENU: RF BW] BW40 is fixed for full analog-FM video bandwidth\n");
            break;
        case 3: /* AFC MODE */
            if (s_afc_mode == AFC_MODE_AUTO) {
                s_afc_mode = AFC_MODE_HOLD;
            } else if (s_afc_mode == AFC_MODE_HOLD) {
                s_afc_mode = AFC_MODE_OFF;
                rf_set_frequency_offset_khz(0);
            } else {
                s_afc_mode = AFC_MODE_AUTO;
            }
            printf("[MENU: AFC] Mode -> %d\n", s_afc_mode);
            break;
        case 4: /* VIDEO STANDARD (NTSC / PAL) */
            menu_toggle_standard();
            printf("[MENU: STD] Switched standard -> %s\n", (s_video_std == VIDEO_STD_PAL) ? "PAL 625i (50Hz)" : "NTSC 525i (60Hz)");
            break;
        case 5: /* SAVE & EXIT */
            video_set_menu_mode(false);
            printf("[BTN: LONG] Menu Closed -> Live Video!\n");
            return;
        default:
            break;
        }
        menu_render_menu();
        s_menu_timeout_ticks = 0;
    }
}


static void analog_agc_task(void *arg)
{
    (void)arg;
    int settle_ticks = 0;
    int drift_counter = 0;
    int lost_counter = 0;
    int afc_ticks = 0;
    int telemetry_ticks = 0;
    uint8_t target_gain = 52u;
    int btn_ticks = 0;
    bool btn_long_fired = false;
    bool was_locked = false;

    int boot_grace_ticks = 20; /* 1.0s boot grace period (20 * 50ms): ignore reset/flash glitches */

    for (;;) {
        vTaskDelay(pdMS_TO_TICKS(50)); /* 20 Hz evaluation (every 50 ms) */

        /* Poll hardware sticky status registers for truthful PARLIO TX starvation detection */
        if (PARL_IO.int_raw.tx_fifo_rempty_int_raw) {
            s_hw_counters.parl_tx_rempty_count++;
            PARL_IO.int_clr.tx_fifo_rempty_int_clr = 1;
        }
        if (PARL_IO.int_raw.rx_fifo_wovf_int_raw) {
            s_hw_counters.parl_rx_wovf_count++;
            PARL_IO.int_clr.rx_fifo_wovf_int_clr = 1;
        }

        int command;
        for (unsigned commands = 0; commands < 16 &&
             xQueueReceive(s_menu_commands, &command, 0) == pdTRUE; ++commands) {
            if (command == 'o') video_set_menu_mode(!s_menu_active);
            else if (command == 'v' || command == 'V') menu_toggle_standard();
            else if (command == 'O') s_menu_boot_btn_enabled = !s_menu_boot_btn_enabled;
            else if (s_menu_active && (command == ' ' || command == 'n' || command == '\t'))
                handle_button_short_click();
            else if (s_menu_active) handle_button_long_click();
        }

        /* 1. BOOT Button Sampling & Debounce (GPIO 28, active LOW) */
        if (boot_grace_ticks > 0) {
            boot_grace_ticks--;
            btn_ticks = 0;
            btn_long_fired = false;
        } else {
            int btn_level = gpio_get_level(BOOT_BTN_GPIO);
            if (btn_level == 0) {
                btn_ticks++;
                if (btn_ticks >= 12 && !btn_long_fired) { /* 600 ms long press */
                    btn_long_fired = true;
                    handle_button_long_click();
                }
            } else {
                if (btn_ticks > 0) {
                    if (!btn_long_fired && btn_ticks >= 2) { /* 100 - 550 ms short click (>= 2 samples) */
                        handle_button_short_click();
                    }
                    btn_ticks = 0;
                    btn_long_fired = false;
                }
            }
        }

        /* 2. Menu Inactivity Timeout (12.0s auto-exit).
         * Zero console I/O or fflush calls inside this loop to guarantee
         * non-blocking execution regardless of USB host connection state! */
        if (s_menu_active) {
            s_menu_timeout_ticks++;
            if (s_menu_timeout_ticks >= 240) { /* 12.0s inactivity auto-exit */
                video_set_menu_mode(false);
                printf("[MENU] Inactivity timeout (12s) -> Live Video\n");
            }
            continue; /* Freeze AGC, AFC, and avoid modifying DMA memory while menu is displayed! */
        }

        /* Read a completed RX descriptor. Sampling s_raw_ring[0] directly can
         * race GDMA and create impossible mixed-window power/coherence metrics. */
        uint8_t *sample_src = get_completed_rx_sample_window(256);
        sync_dma_m2c((void *)sample_src, 256);

        static uint8_t sample_buf[256];
        memcpy(sample_buf, sample_src, sizeof(sample_buf));

        int n_clip = 0;
        int n_origin = 0;
        int n_coherent = 0;
        int sum_cross = 0;
        int sum_dot = 0;
        static uint16_t hist[129];
        memset(hist, 0, sizeof(hist));
        int8_t prev_i = 0, prev_q = 0;

        for (int i = 0; i < 256; i++) {
            uint8_t byte = sample_buf[i];
            int8_t q = (int8_t)((byte & 0x0fu) << 4) >> 4;
            int8_t in_val = (int8_t)(byte & 0xf0u) >> 4;

            if (in_val == -8 || in_val == 7 || q == -8 || q == 7) {
                n_clip++;
            }
            int p = (int)in_val * in_val + (int)q * q;
            if (p <= 4) {
                n_origin++;
            }
            if (p > 128) p = 128;
            hist[p]++;

            if (i > 0) {
                int dot = (int)in_val * (int)prev_i + (int)q * (int)prev_q;
                int signed_cross = (int)q * (int)prev_i - (int)in_val * (int)prev_q;
                int abs_cross = (signed_cross < 0) ? -signed_cross : signed_cross;

                /* Coherent FM sample: carrier power >= 8, phase delta within +-45 deg */
                if (p >= 8 && dot > 0 && abs_cross <= dot) {
                    n_coherent++;
                    sum_cross += signed_cross;
                    sum_dot += dot;
                }
            }
            prev_i = in_val;
            prev_q = q;
        }

        int cum = 0;
        int p_median = 0;
        for (int b = 0; b <= 128; b++) {
            cum += hist[b];
            if (cum >= 128) {
                p_median = b;
                break;
            }
        }
        int q_phase = (n_coherent * 100) / 255;

        s_last_p_median = p_median;
        s_last_q_phase = q_phase;
        s_last_n_clip = n_clip;
        s_last_n_origin = n_origin;

        /* Carrier Frequency Offset (CFO) Calculation:
         * Delta_f = (Cross / Dot) * (fs / 2pi) = (Cross / Dot) * 6366 kHz. */
        if (n_coherent >= 30 && sum_dot > 0) {
            int instant_cfo = (int)(((int64_t)sum_cross * 6366LL) / sum_dot);
            if (instant_cfo > 2000)  instant_cfo = 2000;
            if (instant_cfo < -2000) instant_cfo = -2000;
            s_cfo_khz = (s_cfo_khz * 7 + instant_cfo) / 8;
        }

        if (s_agc_mode == ANALOG_AGC_MANUAL) {
            target_gain = s_current_gain;
            s_shadow_gain = s_current_gain;
            goto apply_target;
        }

        /* Settle delay after gain change */
        if (settle_ticks > 0) {
            settle_ticks--;
            goto update_telemetry;
        }

        /* 2. Fast Overload Safety Rem:
         * Triggers if clipping occurs (n_clip >= 4) AND median power is elevated. */
        if (n_clip >= 4 && p_median > 18) {
            int drop = (n_clip >= 16) ? 6 : 4;
            target_gain = (target_gain > drop + 2) ? (target_gain - drop) : 2;
            s_agc_state = AGC_STATE_LEARN;
            settle_ticks = 2; /* 100 ms settle */
            drift_counter = 0;
            lost_counter = 0;
            goto apply_target;
        }

        /* 3. State Machine */
        switch (s_agc_state) {
        case AGC_STATE_SEARCH:
            /* Sensitive carrier detection: coherent phase, power, or departure from origin */
            if (q_phase >= 25 || p_median >= 8 || n_origin < 180) {
                s_agc_state = AGC_STATE_LEARN;
                drift_counter = 0;
                lost_counter = 0;
            } else {
                /* No verified carrier: stay at maximum receive gain. This also
                 * allows the BW gearbox to enter BW20 while searching, so a
                 * carrier that is only recoverable in the narrow mode can be acquired. */
                target_gain = 62u;
            }
            break;

        case AGC_STATE_LEARN:
            /* Signal too hot or clipping: step gain down */
            if (p_median > 34 || n_clip >= 6) {
                int drop = (n_clip >= 12) ? 6 : 4;
                target_gain = (target_gain > drop + 2) ? (target_gain - drop) : 2;
                settle_ticks = 6; /* 300 ms settle between adjustments */
            }
            /* Signal weak or picture degrading: actively step gain UP towards 62 */
            else if ((p_median < 16 || q_phase < 55) && target_gain < 62u && n_clip <= 2) {
                int step = (q_phase < 40 || p_median < 12) ? 4 : 2;
                if ((int)target_gain + step <= 62) {
                    target_gain += step;
                } else {
                    target_gain = 62u;
                }
                settle_ticks = 6; /* 300 ms settle between adjustments */
            }
            /* Optimal target zone converged */
            else {
                /* TRACK requires an actually coherent FM carrier */
                if (n_clip <= 3 && q_phase >= 55) {
                    s_agc_state = AGC_STATE_TRACK;
                    drift_counter = 0;
                    lost_counter = 0;
                }
            }
            break;

        case AGC_STATE_TRACK:
            /* Check for total carrier loss: 500 ms persistent loss */
            if (q_phase < 25 && p_median < 12) {
                lost_counter++;
                if (lost_counter >= 10) { /* ~500 ms persistent loss */
                    s_agc_state = AGC_STATE_SEARCH;
                    lost_counter = 0;
                    break;
                }
            } else {
                lost_counter = 0;
            }

            /* Rock-solid hysteresis deadband:
             * 1. Needs boost: signal has genuinely degraded persistently
             *    (Q_phase < 45% or P_median < 14) while not at maximum gain.
             * 2. Needs cut: signal is hard clipping (P_median > 36 or n_clip >= 8). */
            bool needs_gain_boost = (q_phase < 45 || p_median < 14) && (target_gain < 62u) && (n_clip <= 2);
            bool needs_gain_cut   = (p_median > 36) || (n_clip >= 8);

            if (needs_gain_boost || needs_gain_cut) {
                drift_counter++;
                if (drift_counter >= 15) { /* Must persist for 750 ms continuously! */
                    s_agc_state = AGC_STATE_LEARN;
                    drift_counter = 0;
                }
            } else {
                drift_counter = 0;
                /* Inside wide deadband: 100% frozen, ZERO register writes */
            }
            break;
        }

apply_target:
        s_shadow_gain = target_gain;
        if (s_agc_mode == ANALOG_AGC_ACTIVE) {
            if (target_gain != s_current_gain) {
                uint8_t old_g = s_current_gain;
                s_current_gain = target_gain;
                rf_set_rx_gain(true, s_current_gain);
                settle_ticks = 10; /* 500 ms settle delay after RF gain write to prevent rapid staircasing */
                printf("[AGC:GAIN] %u -> %u (P_med=%d, Q_phase=%d%%, Clip=%d, State=%s)\n",
                       old_g, s_current_gain, p_median, q_phase, n_clip,
                       (s_agc_state == AGC_STATE_TRACK) ? "TRACK" :
                       (s_agc_state == AGC_STATE_LEARN) ? "LEARN" : "SRCH");
            }
        }

        /* RF bandwidth is intentionally fixed at BW40. Narrowing the
         * pre-discriminator PHY filter damaged analog-FM chroma/detail in
         * hardware tests and runtime switching adds an unnecessary RF transient. */

        /* 4. Experimental AFC.
         * Default is OFF: mean WBFM phase slope over a 6.4 us window includes
         * video modulation and is NOT a calibrated absolute carrier offset.
         * AUTO remains an explicit test mode only. */
        if (s_afc_mode == AFC_MODE_AUTO) {
            /* Only adjust if carrier is strongly locked (Q_phase >= 75%) and gain settled */
            if (q_phase >= 75 && p_median >= 18 && settle_ticks == 0) {
                /* Centering deadband: +/- 35 kHz. Inside deadband = 0 register writes */
                if (s_cfo_khz > 35 || s_cfo_khz < -35) {
                    afc_ticks++;
                    if (afc_ticks >= 20) { /* Persisted for 1.0 second */
                        int cur_offset = rf_get_frequency_offset_khz();
                        int target_offset = cur_offset + s_cfo_khz;
                        rf_set_frequency_offset_khz(target_offset);
                        afc_ticks = 0;
                        settle_ticks = 2;
                    }
                } else {
                    afc_ticks = 0;
                }
            } else {
                afc_ticks = 0; /* Frozen during noise or deep fades: NO drifting away! */
            }
        } else if (s_afc_mode == AFC_MODE_OFF) {
            if (rf_get_frequency_offset_khz() != 0) {
                rf_set_frequency_offset_khz(0);
            }
        }

        /* 5. Transient Carrier Lock Detection */
        bool is_locked = (s_agc_state == AGC_STATE_TRACK) && (q_phase >= 55);
        if (is_locked && !was_locked) {
            const fpv_channel_t *ch = rf_get_current_channel();
            printf("[CARRIER] Locked on %s (%u MHz) in %s (P_med=%d, Q_phase=%d%%, G=%u)\n",
                   ch->name, ch->freq_mhz, rf_get_band_name(rf_get_current_band()),
                   p_median, q_phase, s_current_gain);
        }
        was_locked = is_locked;


update_telemetry:
        telemetry_ticks++;
        if (telemetry_ticks >= 20) { /* 1 Hz periodic telemetry log */
            telemetry_ticks = 0;
            const fpv_channel_t *ch = rf_get_current_channel();
            int cur_off = rf_get_frequency_offset_khz();
            int total_khz = (int)ch->freq_mhz * 1000 + cur_off;
            printf("[AGC:%s] %-5s BW=%-4s | %s:%d.%03dMHz %+4dkHz (CFO=%+4d kHz) | G=%u | P=%-2d Q=%2d%% | c=%-2d\n",
                   (s_agc_mode == ANALOG_AGC_ACTIVE) ? "ACT" :
                   (s_agc_mode == ANALOG_AGC_SHADOW) ? "SHD" : "MAN",
                   (s_agc_state == AGC_STATE_TRACK) ? "TRACK" :
                   (s_agc_state == AGC_STATE_LEARN) ? "LEARN" : "SRCH",
                   "BW40",
                   ch->name,
                   total_khz / 1000,
                   (total_khz % 1000 >= 0 ? total_khz % 1000 : -(total_khz % 1000)),
                   cur_off,
                   s_cfo_khz,
                   s_current_gain,
                   s_last_p_median, s_last_q_phase, s_last_n_clip);
        }
    }
}

static void console_diag_task(void *arg)
{
    (void)arg;

    for (;;) {
        /* IDF 6.0's O_NONBLOCK VFS read consults the installed driver's
         * available-byte count even in no-driver mode. Poll the FIFO here;
         * this task is its sole reader. Bound each batch so paste cannot
         * monopolize the task. No host line-ending or DTR assumption. */
        for (unsigned received = 0; received < 64; ++received) {
            uint8_t byte;
            if (usb_serial_jtag_ll_read_rxfifo(&byte, 1) == 0) break;
            int c = byte;
            if (c != EOF && c > 0) {
                if (c == '+' || c == 'k') {
                    s_agc_mode = ANALOG_AGC_MANUAL;
                    if (s_current_gain < 62u) s_current_gain += 2u;
                    rf_set_rx_gain(true, s_current_gain);
                    printf("[MANUAL GAIN] = %u (reg=0x%08lx)\n", s_current_gain, (unsigned long)rf_get_rx_gain_reg());
                } else if (c == '-' || c == 'j') {
                    s_agc_mode = ANALOG_AGC_MANUAL;
                    if (s_current_gain >= 2u) s_current_gain -= 2u;
                    rf_set_rx_gain(true, s_current_gain);
                    printf("[MANUAL GAIN] = %u (reg=0x%08lx)\n", s_current_gain, (unsigned long)rf_get_rx_gain_reg());
                } else if (c == 'a') {
                    s_agc_mode = ANALOG_AGC_ACTIVE;
                    printf("[AGC MODE] -> ACTIVE (Self-Calibrating Adaptive Gain Controller ACTIVE)\n");
                } else if (c == 's') {
                    s_agc_mode = ANALOG_AGC_SHADOW;
                    printf("[AGC MODE] -> SHADOW (Dry-run: RF gain frozen at %u, computing recommendations)\n", s_current_gain);
                } else if (c == 'm') {
                    s_agc_mode = ANALOG_AGC_MANUAL;
                    printf("[AGC MODE] -> MANUAL (Fixed gain=%u)\n", s_current_gain);
                } else if (c == 'c') {
                    rf_cycle_channel_in_band();
                    const fpv_channel_t *ch = rf_get_current_channel();
                    s_cfo_khz = 0;
                    s_agc_state = AGC_STATE_SEARCH;
                    printf("[CHANNEL] Switched to %s (%u MHz) in %s\n",
                           ch->name, ch->freq_mhz, rf_get_band_name(rf_get_current_band()));
                } else if (c == 'C') {
                    rf_cycle_band();
                    const fpv_channel_t *ch = rf_get_current_channel();
                    s_cfo_khz = 0;
                    s_agc_state = AGC_STATE_SEARCH;
                    printf("[BAND] Switched to %s - Channel %s (%u MHz)\n",
                           rf_get_band_name(rf_get_current_band()), ch->name, ch->freq_mhz);
                } else if (c == 'f') {
                    if (s_afc_mode == AFC_MODE_AUTO) {
                        s_afc_mode = AFC_MODE_HOLD;
                        printf("[AFC] -> HOLD (Current offset %+d kHz frozen)\n", rf_get_frequency_offset_khz());
                    } else if (s_afc_mode == AFC_MODE_HOLD) {
                        s_afc_mode = AFC_MODE_OFF;
                        rf_set_frequency_offset_khz(0);
                        printf("[AFC] -> OFF (Offset reset to 0 kHz)\n");
                    } else {
                        s_afc_mode = AFC_MODE_AUTO;
                        printf("[AFC] -> AUTO EXPERIMENTAL (uncalibrated WBFM bias estimator)\n");
                    }
                } else if (c == ',' || c == '<') {
                    rf_step_frequency_offset_khz(-50);
                    int off = rf_get_frequency_offset_khz();
                    int tot = (int)rf_get_current_channel()->freq_mhz * 1000 + off;
                    printf("[FINE TUNE] Offset = %+d kHz (Tuned: %d.%03d MHz)\n",
                           off, tot / 1000, (tot % 1000 >= 0 ? tot % 1000 : -(tot % 1000)));
                } else if (c == '.' || c == '>') {
                    rf_step_frequency_offset_khz(+50);
                    int off = rf_get_frequency_offset_khz();
                    int tot = (int)rf_get_current_channel()->freq_mhz * 1000 + off;
                    printf("[FINE TUNE] Offset = %+d kHz (Tuned: %d.%03d MHz)\n",
                           off, tot / 1000, (tot % 1000 >= 0 ? tot % 1000 : -(tot % 1000)));
                } else if (c == '0') {
                    rf_set_frequency_offset_khz(0);
                    printf("[FINE TUNE] Offset reset to +0 kHz\n");
                } else if (c == 'e') {
                    PARL_IO.rx_clk_cfg.rx_clk_i_inv = !PARL_IO.rx_clk_cfg.rx_clk_i_inv;
                    printf("[EDGE] RX SAMPLE EDGE TOGGLED -> %s (rx_clk_i_inv=%d)\n",
                           PARL_IO.rx_clk_cfg.rx_clk_i_inv ? "NEG" : "POS",
                           (int)PARL_IO.rx_clk_cfg.rx_clk_i_inv);
                } else if (c == 'o' || c == 'v' || c == 'V' || c == 'O' ||
                           c == ' ' || c == 'n' || c == '\t' ||
                           c == '\r' || c == '\n' || c == 'x') {
                    /* The control task exclusively owns mode changes and rendering. */
                    if (xQueueSend(s_menu_commands, &c, 0) != pdTRUE) {
                        printf("[MENU] Command queue full\n");
                    }
                } else {
                    uint32_t rx_dscr = 0, tx_dscr = 0;
                    uint32_t rx_off = get_rx_dma_offset(&rx_dscr);
                    uint32_t tx_off = get_tx_dma_offset(&tx_dscr);
                    uint32_t dist = (rx_off >= tx_off) ? (rx_off - tx_off) : (sizeof(s_raw_ring) - tx_off + rx_off);
                    int rx_nodes = s_rx_dscr_count;
                    int tx_nodes = s_menu_active ? 0 : s_tx_dscr_count;
                    const fpv_channel_t *ch = rf_get_current_channel();
                    int off = rf_get_frequency_offset_khz();
                    int tot = (int)ch->freq_mhz * 1000 + off;

                    printf("\n=======================================================\n");
                    printf(" C5VRX-3 REALTIME RECEPTION & FREQUENCY DIAGNOSTICS\n");
                    printf(" Receiver Channel:           %s (%u MHz)\n", ch->name, ch->freq_mhz);
                    printf(" Tuned Frequency:            %d.%03d MHz (Offset: %+d kHz)\n",
                           tot / 1000, (tot % 1000 >= 0 ? tot % 1000 : -(tot % 1000)), off);
                    printf(" Carrier Frequency Offset:   %+d kHz (VTX %s)\n",
                           s_cfo_khz, (s_cfo_khz > 20) ? "high" : (s_cfo_khz < -20) ? "low" : "centered");
                    printf(" AFC Mode:                   %s\n",
                           (s_afc_mode == AFC_MODE_AUTO) ? "AUTO EXPERIMENTAL (uncalibrated estimator)" :
                           (s_afc_mode == AFC_MODE_HOLD) ? "HOLD (Offset Frozen)" : "OFF (0 kHz)");
                    printf(" RF Bandwidth:               BW40 (fixed production mode)\n");
                    printf(" Adaptive AGC Mode:          %s (State=%s)\n",
                           (s_agc_mode == ANALOG_AGC_ACTIVE) ? "ACTIVE" :
                           (s_agc_mode == ANALOG_AGC_SHADOW) ? "SHADOW (Safe Dry-Run)" : "MANUAL",
                           (s_agc_state == AGC_STATE_TRACK) ? "TRACK" :
                           (s_agc_state == AGC_STATE_LEARN) ? "LEARN" : "SEARCH");
                    printf(" Gain Settings:              G_actual=%u, G_shadow_rec=%u (reg=0x%08lx)\n",
                           s_current_gain, s_shadow_gain, (unsigned long)rf_get_rx_gain_reg());
                    printf(" FM Vector Metrics:          P_median=%d, Q_phase=%d%%, Clip=%d, Origin=%d\n",
                           s_last_p_median, s_last_q_phase, s_last_n_clip, s_last_n_origin);
                    printf(" GDMA Ring:                  dist=%lu (rx_off=%lu, tx_off=%lu)\n",
                           (unsigned long)dist, (unsigned long)rx_off, (unsigned long)tx_off);
                    printf(" Zero-EOF Status:            RX patched=%d nodes, TX patched=%d nodes\n",
                           rx_nodes, tx_nodes);
                    printf(" PARLIO TX Underflows:       %lu (Zero underflows)\n",
                           (unsigned long)s_hw_counters.parl_tx_rempty_count);
                    printf(" RX Sample Edge:             %s (rx_clk_i_inv=%d)\n",
                           PARL_IO.rx_clk_cfg.rx_clk_i_inv ? "NEG" : "POS",
                           (int)PARL_IO.rx_clk_cfg.rx_clk_i_inv);
                    printf(" Menu Standard:              %s (%s)\n",
                           (s_video_std == VIDEO_STD_PAL) ? "PAL 625i" : "NTSC 525i",
                           (s_video_std == VIDEO_STD_PAL) ? "50Hz, 625 lines/frame" : "59.94Hz, 525 lines/frame");
                    printf(" Menu Status:                %s (BOOT button trigger: %s)\n",
                           s_menu_active ? "OPEN" : "CLOSED",
                           s_menu_boot_btn_enabled ? "ENABLED" : "DISABLED (Safe Flight Mode)");
                    printf(" Keys:\n");
                    printf("  'a'/'s'/'m': AGC mode (active / shadow / manual)\n");
                    printf("  '+' / '-':   Manual gain step (+/-2)\n");
                    printf("  'c':         Cycle FPV channel (A1..A8, R1..R8, B1..B8, F1..F8)\n");
                    printf("  'f':         AFC mode (auto-centering / hold / off)\n");
                    printf("  ',' / '.':   Fine-tune offset (-50 / +50 kHz)\n");
                    printf("  '0':         Reset offset to 0 kHz\n");
                    printf("  'e':         Toggle RX sample edge (POS/NEG)\n");
                    printf("  'v':         Toggle Video Standard (NTSC 525i / PAL 625i)\n");
                    printf("  'o':         Toggle menu via console\n");
                    printf("  'O':         Toggle BOOT button menu trigger (Safe Flight Mode)\n");
                    printf("  'd':         Print this diagnostic summary\n");
                    printf("=======================================================\n\n");
                }
            }
        }
        vTaskDelay(pdMS_TO_TICKS(10));
    }
}


/* ----- Main entry point ----- */

esp_err_t video_start(void)
{
    /* Keep output unbuffered on the no-driver USB VFS. Input is drained directly
     * by console_diag_task; USB is never involved in DMA sample pacing. */
    setvbuf(stdin, NULL, _IONBF, 0);
    setvbuf(stdout, NULL, _IONBF, 0);
    int flags = fcntl(fileno(stdin), F_GETFL, 0);
    fcntl(fileno(stdin), F_SETFL, flags | O_NONBLOCK);
    flags = fcntl(fileno(stdout), F_GETFL, 0);
    fcntl(fileno(stdout), F_SETFL, flags | O_NONBLOCK);
    usb_serial_jtag_vfs_use_nonblocking();

    /* Initialize BOOT button on GPIO 28 */
    init_boot_button();

    /* Menu control is serialized with BOOT handling in the AGC task. */
    s_menu_commands = xQueueCreate(16, sizeof(int));
    if (!s_menu_commands) return ESP_ERR_NO_MEM;

    /* Zero the ring before starting. Flush to DMA-visible SRAM. */
    memset(s_raw_ring, 0, sizeof(s_raw_ring));
    sync_dma_c2m(s_raw_ring, sizeof(s_raw_ring));

    esp_err_t err;

    if ((err = prepare_rx()) != ESP_OK) return err;
    if ((err = prepare_tx()) != ESP_OK) return err;

    start_flight_demodulator();

    /* Start RX cyclic ring. GDMA begins writing at s_raw_ring[0]. */
    if ((err = start_rx()) != ESP_OK) return err;

    /* Put PARLIO RX into pure continuous hardware mode:
     * 1. Disable all GDMA RX channel interrupts so the CPU is never interrupted
     *    (~9,775 ISRs/sec eliminated!).
     * 2. Set rx_eof_gen_sel = 1 (external enable, non-existent in soft mode)
     *    so PARLIO RX never generates an EOF stall event.
     * This matches PARLIO TX's unbroken hardware loop, eliminating pointer drift! */
    AHB_DMA.in_intr[0].ena.val = 0;
    AHB_DMA.in_intr[1].ena.val = 0;
    AHB_DMA.in_intr[2].ena.val = 0;
    PARL_IO.rx_genrl_cfg.rx_eof_gen_sel = 1;

    /* Request half-ring producer/consumer separation before starting TX.
     * The integer-microsecond delay and driver latency need hardware validation. */
    esp_rom_delay_us(8192ULL * 1000000ULL / IQ_RATE_HZ);

    if ((err = start_tx()) != ESP_OK) return err;

    /* Discover AHB_DMA channels assigned to PARL_IO (peripheral ID 9) */
    for (int i = 0; i < 3; i++) {
        if (AHB_DMA.channel[i].in.in_peri_sel.peri_in_sel_chn == 9) {
            s_rx_dma_ch = i;
        }
        if (AHB_DMA.channel[i].out.out_peri_sel.peri_out_sel_chn == 9) {
            s_tx_dma_ch = i;
        }
    }

    /* Put PARLIO TX into pure continuous hardware mode:
     * Disable all GDMA TX channel interrupts and PARL_IO core interrupts.
     * Prevents PARLIO_LL_EVENT_TX_FIFO_EMPTY and EOF interrupts from stealing CPU cycles! */
    AHB_DMA.out_intr[0].ena.val = 0;
    AHB_DMA.out_intr[1].ena.val = 0;
    AHB_DMA.out_intr[2].ena.val = 0;
    PARL_IO.int_ena.val = 0;

    /* Clear suc_eof on ALL GDMA descriptors for both RX and TX to eliminate
     * hardware wrap EOF bubbles completely! The buffer becomes a truly infinite ring. */
    int rx_nodes = patch_descriptors_clear_eof(s_rx_dma_ch, true);
    int tx_nodes = patch_descriptors_clear_eof(s_tx_dma_ch, false);

    /* Start interactive console for on-demand diagnostics (zero periodic CPU/bus traffic) */
    xTaskCreate(console_diag_task, "console_diag", 3072, NULL, 1, NULL);

    /* Start dedicated Analog Video AGC engine (P_median in [20, 30], fast attack) */
    xTaskCreate(analog_agc_task, "analog_agc", 8192, NULL, 3, NULL);


    /* Print startup stamp (visible on serial monitor at boot). */
    ESP_EARLY_LOGW(TAG,
        "\n=======================================================\n"
        " C5VRX-3  Seamless 16K Phase5 receiver (Zero-EOF Circular GDMA)\n"
        " Clock:   PARLIO_CLK_SRC_DEFAULT 40MHz (SPLL internal)\n"
        " Telemetry: Live GDMA ring pointer tracking (rx_ch=%d, tx_ch=%d)\n"
        " Buffer:  16,384 bytes cyclic ring (Zero-EOF patched: RX=%d TX=%d)\n"
        " RX:      40 MS/s POS edge, 16,384 bytes pure HW cyclic GDMA\n"
        " Demod:   Phase5 50ns / P%u / G%u / current-minus-previous\n"
        " TX:      40 MHz [D,D] / eof=downstream / tail=0\n"
        " Lock:    GDMA ISRs disabled, RX EOF disabled, suc_eof=0 cleared\n"
        " CPU:     done (hardware runs in unbroken infinite loop)\n"
        "=======================================================\n",
        s_rx_dma_ch, s_tx_dma_ch, rx_nodes, tx_nodes, DAC_IDLE_CODE, 2u);

    return ESP_OK;
}
